## chip/rts3917/sdk/rts39xx_sdk_v5.3/platform/package/buildroot/Config.in
```kconfig
source "$BR2_EXTERNAL_platform_PATH/package/buildroot/linux/Config.in"
source "$BR2_EXTERNAL_platform_PATH/package/buildroot/fs/Config.in"
```

## chip/rts3917/sdk/rts39xx_sdk_v5.3/platform/package/buildroot/Config.in.host
```kconfig
source "$BR2_EXTERNAL_platform_PATH/package/buildroot/python3-pycryptodomex/Config.in.host"
source "$BR2_EXTERNAL_platform_PATH/package/buildroot/python3-pyparsing/Config.in.host"
source "$BR2_EXTERNAL_platform_PATH/package/buildroot/python3-pydevicetree/Config.in.host"
source "$BR2_EXTERNAL_platform_PATH/package/buildroot/cpio/Config.in.host"
```

## chip/rts3917/sdk/rts39xx_sdk_v5.3/platform/package/buildroot/cpio/Config.in.host
```kconfig
config BR2_PACKAGE_HOST_CPIO
	bool "host cpio"
	help
	  cpio
	  https://www.gnu.org/software/cpio/
```

## chip/rts3917/sdk/rts39xx_sdk_v5.3/platform/package/buildroot/fs/Config.in
```kconfig
source "$BR2_EXTERNAL_platform_PATH/package/buildroot/fs/initramfs-mini/Config.in"
```

## chip/rts3917/sdk/rts39xx_sdk_v5.3/platform/package/buildroot/fs/initramfs-mini/Config.in
```kconfig
menuconfig BR2_TARGET_ROOTFS_INITRAMFS_MINI
	bool "mini-initial RAM filesystem linked into linux kernel"
	select BR2_TARGET_ROOTFS_INITRAMFS
	select BR2_PACKAGE_LIBFSMGR
	help
		Make sense: you would end up having two identical root
		filesystems, one embedded inside the kernel image, and
		one separately.

	config BR2_TARGET_ROOTFS_INITRAMFS_MINI_INCLUDE
		string "mini-initramfs include"
		default "libfsmgr"
		depends on BR2_TARGET_ROOTFS_INITRAMFS_MINI
		help
			The packages listed in the string will be
			installed into the mini-initramfs.

	config BR2_CONFIG_INITRAMFS_MINI_BUSYBOX_SOURCE
		string "mini-initramfs busybox source"
		default "$(BR2_EXTERNAL)/scripts/busybox"
		depends on BR2_TARGET_ROOTFS_INITRAMFS_MINI
		help
			Specify the busybox file in mini-initramfs. If empty,
			use buildroot's own.

	config BR2_CONFIG_INITRAMFS_MINI_INIT_SOURCE
		string "mini-initramfs init source"
		default "$(BR2_EXTERNAL)/scripts/init"
		depends on BR2_TARGET_ROOTFS_INITRAMFS_MINI
		help
			Specify the init file in mini-initramfs. If empty,
			use buildroot's own.
```

## chip/rts3917/sdk/rts39xx_sdk_v5.3/platform/package/buildroot/linux/Config.in
```kconfig
config BR2_LINUX_KERNEL_DTB_CHECK
	bool "Device Tree Source file binding check"
	select BR2_PACKAGE_HOST_PYTHON3
	select BR2_PACKAGE_HOST_PYTHON3_SSL
	default y
	help
		The tool which can validate dts and binding files
```

## chip/rts3917/sdk/rts39xx_sdk_v5.3/platform/package/buildroot/python3-pycryptodomex/Config.in.host
```kconfig
config BR2_PACKAGE_HOST_PYTHON3_PYCRYPTODOMEX
	bool "host python3-pycryptodomex"
	help
	  Cryptographic library for Python.

	  http://www.pycryptodome.org
```

## chip/rts3917/sdk/rts39xx_sdk_v5.3/platform/package/buildroot/python3-pydevicetree/Config.in.host
```kconfig
config BR2_PACKAGE_HOST_PYTHON3_PYDEVICETREE
	bool "host python3-pydevicetree"
	select BR2_PACKAGE_HOST_PYTHON3_PYPARSING
	help
	  This is a Python 3 library for parsing, querying, and
	  modifying Devicetree Source v1 files as described in
	  the Devicetree Sepecification V0.2.
```

## chip/rts3917/sdk/rts39xx_sdk_v5.3/platform/package/driver/Config.in
```kconfig
menu "Module drivers"

menu "wifi driver"

source "$BR2_EXTERNAL_platform_PATH/package/driver/kmod_rtl8188eus/Config.in"
source "$BR2_EXTERNAL_platform_PATH/package/driver/kmod_rtl8188fu/Config.in"
source "$BR2_EXTERNAL_platform_PATH/package/driver/kmod_rtl8189es/Config.in"
source "$BR2_EXTERNAL_platform_PATH/package/driver/kmod_rtl8189fs/Config.in"
source "$BR2_EXTERNAL_platform_PATH/package/driver/kmod_rtl8192eus/Config.in"
source "$BR2_EXTERNAL_platform_PATH/package/driver/kmod_rtl8192es/Config.in"
source "$BR2_EXTERNAL_platform_PATH/package/driver/kmod_rtl8192fu/Config.in"
source "$BR2_EXTERNAL_platform_PATH/package/driver/kmod_rtl8812au/Config.in"
source "$BR2_EXTERNAL_platform_PATH/package/driver/kmod_rtl8821au/Config.in"
source "$BR2_EXTERNAL_platform_PATH/package/driver/kmod_rtl8723bu/Config.in"
source "$BR2_EXTERNAL_platform_PATH/package/driver/kmod_rtl8723du/Config.in"
source "$BR2_EXTERNAL_platform_PATH/package/driver/kmod_rtl88x2bu/Config.in"
source "$BR2_EXTERNAL_platform_PATH/package/driver/kmod_rtl8723ds/Config.in"
source "$BR2_EXTERNAL_platform_PATH/package/driver/kmod_rtl8822cs/Config.in"
source "$BR2_EXTERNAL_platform_PATH/package/driver/kmod_rtl8822cu/Config.in"
source "$BR2_EXTERNAL_platform_PATH/package/driver/kmod_rtl8733bu/Config.in"
source "$BR2_EXTERNAL_platform_PATH/package/driver/kmod_rtl8821cu/Config.in"
source "$BR2_EXTERNAL_platform_PATH/package/driver/kmod_rtl8852bu/Config.in"
source "$BR2_EXTERNAL_platform_PATH/package/driver/kmod_rtl8830au/Config.in"
source "$BR2_EXTERNAL_platform_PATH/package/driver/kmod_aic8800/Config.in"
source "$BR2_EXTERNAL_platform_PATH/package/driver/kmod_rtl8723cu/Config.in"

config BR2_CONFIG_RTW_COMPILER_OPTIMIZATION
	bool "Adjust Compiler's optimization level from O1 to Os"
	default y

config BR2_CONFIG_RTW_MINIMAL_MEMORY_USAGE
	bool "Enable Minimal Memory Usage"
	default y

config BR2_CONFIG_RTS_MESH
	bool "Enable RTS Mesh"
	select BR2_PACKAGE_IW
	default n

config BR2_CONFIG_RTW_CONCURRENT_MODE
	bool "Enable RTW Concurrent Mode"
	default n
	help
	  realtek WiFi softap coexists with station mode

endmenu

menu "bluetooth driver"
source "$BR2_EXTERNAL_platform_PATH/package/driver/kmod_rtl8723bt/Config.in"
source "$BR2_EXTERNAL_platform_PATH/package/driver/kmod_rtl8723dbt/Config.in"
source "$BR2_EXTERNAL_platform_PATH/package/driver/kmod_rtl8761bt/Config.in"
source "$BR2_EXTERNAL_platform_PATH/package/driver/kmod_rtl8723ds_bt/Config.in"
source "$BR2_EXTERNAL_platform_PATH/package/driver/kmod_rtl8822cs_bt/Config.in"
source "$BR2_EXTERNAL_platform_PATH/package/driver/kmod_rtl8822cu_bt/Config.in"
source "$BR2_EXTERNAL_platform_PATH/package/driver/kmod_rtl8821cu_bt/Config.in"
source "$BR2_EXTERNAL_platform_PATH/package/driver/kmod_aic8800/Config.in"
source "$BR2_EXTERNAL_platform_PATH/package/driver/kmod_rtl8723cu_bt/Config.in"
endmenu

menu "ptz driver"
source "$BR2_EXTERNAL_platform_PATH/package/driver/kmod_ptz/Config.in"
endmenu

menu "iot driver"
source "$BR2_EXTERNAL_platform_PATH/package/driver/kmod_gobinet/Config.in"
endmenu

endmenu
```

## chip/rts3917/sdk/rts39xx_sdk_v5.3/platform/package/driver/kmod_aic8800/Config.in
```kconfig
config BR2_PACKAGE_KMOD_AIC8800
	bool "AIC8800 support"
	depends on BR2_LINUX_KERNEL
	select BR2_PACKAGE_AIC_LOAD_FW
	help
	  AIC8800

	comment "kmod_AIC8800D80 needs a Linux kernel to be built"
	depends on !BR2_LINUX_KERNEL

if BR2_PACKAGE_KMOD_AIC8800
		config BR2_PACKAGE_AIC_LOAD_FW
		bool "install aic firmware"
		help
			install aic firmware

		config BR2_PACKAGE_AIC8800D80_FDRV
		bool "AIC8800D80 wifi driver"
		help
			AIC8800D80 wifi driver
endif
```

## chip/rts3917/sdk/rts39xx_sdk_v5.3/platform/package/driver/kmod_gobinet/Config.in
```kconfig
config BR2_PACKAGE_KMOD_GOBINET
	bool "Gobinet driver for Quectel EC2x modem"
	depends on BR2_LINUX_KERNEL
	help
	  Gobinet driver for Quectel EC20 USB LTE Modem

comment "kmod_gobinet needs a Linux kernel to be built"
	depends on !BR2_LINUX_KERNEL
```

## chip/rts3917/sdk/rts39xx_sdk_v5.3/platform/package/driver/kmod_ptz/Config.in
```kconfig
config BR2_PACKAGE_KMOD_PTZ
	bool "ptz"
	depends on BR2_LINUX_KERNEL
	help
	  ptz

comment "kmod_ptz needs a Linux kernel to be built"
	depends on !BR2_LINUX_KERNEL

if BR2_PACKAGE_KMOD_PTZ
	choice
		prompt "device type"
		default BR2_PACKAGE_KMOD_PTZ_GPIO

		config BR2_PACKAGE_KMOD_PTZ_GPIO
		bool "ptz drived by gpio"
		help
		  ptz drived by gpio

		config BR2_PACKAGE_KMOD_PTZ_595
		bool "ptz drived by 74hc595"
		help
		  ptz drived by 74hc595

        config BR2_PACKAGE_KMOD_PTZ_TUYA
		bool "ptz drived by tuya"
		help
		  ptz drived by tuya

	endchoice
endif
```

## chip/rts3917/sdk/rts39xx_sdk_v5.3/platform/package/driver/kmod_rtl8188eus/Config.in
```kconfig
config BR2_PACKAGE_KMOD_RTL8188EUS
	bool "Realtek RTL8188E USB WiFi"
	depends on BR2_LINUX_KERNEL &&  BR2_LINUX_KERNEL_CUSTOM_VERSION_VALUE = "4.9"
	help
	  realtek rtl8188e usb wifi card driver

comment "kmod_rtl8188eus needs a Linux kernel to be built"
	depends on !BR2_LINUX_KERNEL
```

## chip/rts3917/sdk/rts39xx_sdk_v5.3/platform/package/driver/kmod_rtl8188fu/Config.in
```kconfig
config BR2_PACKAGE_KMOD_RTL8188FU
	bool "Realtek RTL8188F USB WiFi"
	depends on BR2_LINUX_KERNEL
	help
	  realtek rtl8188f usb wifi card driver

comment "kmod_rtl8188fu needs a Linux kernel to be built"
	depends on !BR2_LINUX_KERNEL
```

## chip/rts3917/sdk/rts39xx_sdk_v5.3/platform/package/driver/kmod_rtl8189es/Config.in
```kconfig
config BR2_PACKAGE_KMOD_RTL8189ES
	bool "Realtek RTL8189E SDIO WiFi"
	depends on BR2_LINUX_KERNEL
	help
	  realtek rtl8189e sdio wifi card driver

comment "kmod_rtl8189es needs a Linux kernel to be built"
	depends on !BR2_LINUX_KERNEL
```

## chip/rts3917/sdk/rts39xx_sdk_v5.3/platform/package/driver/kmod_rtl8189fs/Config.in
```kconfig
config BR2_PACKAGE_KMOD_RTL8189FS
	bool "Realtek RTL8189F SDIO WiFi"
	depends on BR2_LINUX_KERNEL &&  BR2_LINUX_KERNEL_CUSTOM_VERSION_VALUE = "4.9"
	help
	  realtek rtl8189f sdio wifi card driver

comment "kmod_rtl8189fs needs a Linux kernel to be built"
	depends on !BR2_LINUX_KERNEL
```

## chip/rts3917/sdk/rts39xx_sdk_v5.3/platform/package/driver/kmod_rtl8192es/Config.in
```kconfig
config BR2_PACKAGE_KMOD_RTL8192ES
	bool "Realtek RTL8192E SDIO WiFi"
	depends on BR2_LINUX_KERNEL &&  BR2_LINUX_KERNEL_CUSTOM_VERSION_VALUE = "4.9"
	help
	  realtek rtl8192e sdio wifi card driver

comment "kmod_rtl8192es needs a Linux kernel to be built"
	depends on !BR2_LINUX_KERNEL
```

## chip/rts3917/sdk/rts39xx_sdk_v5.3/platform/package/driver/kmod_rtl8192eus/Config.in
```kconfig
config BR2_PACKAGE_KMOD_RTL8192EUS
	bool "Realtek RTL8192E USB WiFi"
	depends on BR2_LINUX_KERNEL &&  BR2_LINUX_KERNEL_CUSTOM_VERSION_VALUE = "4.9"
	help
	  realtek rtl8192e usb wifi card driver

comment "kmod_rtl8192eus needs a Linux kernel to be built"
	depends on !BR2_LINUX_KERNEL
```

## chip/rts3917/sdk/rts39xx_sdk_v5.3/platform/package/driver/kmod_rtl8192fu/Config.in
```kconfig
config BR2_PACKAGE_KMOD_RTL8192FU
	bool "Realtek RTL8192F USB WiFi"
	depends on BR2_LINUX_KERNEL &&  BR2_LINUX_KERNEL_CUSTOM_VERSION_VALUE = "4.9"
	help
	  realtek rtl8192f usb wifi card driver

comment "kmod_rtl8192f needs a Linux kernel to be built"
	depends on !BR2_LINUX_KERNEL
```

## chip/rts3917/sdk/rts39xx_sdk_v5.3/platform/package/driver/kmod_rtl8723bt/Config.in
```kconfig
config BR2_PACKAGE_KMOD_RTL8723BT
	bool "Realtek RTL8723b USB Bluetooth"
	depends on BR2_LINUX_KERNEL
	help
	  realtek rtl8723b usb bluetooth card driver

comment "kmod_rtl8723bt needs a Linux kernel to be built"
	depends on !BR2_LINUX_KERNEL
```

## chip/rts3917/sdk/rts39xx_sdk_v5.3/platform/package/driver/kmod_rtl8723bu/Config.in
```kconfig
config BR2_PACKAGE_KMOD_RTL8723BU
	bool "Realtek RTL8723B USB WiFi"
	depends on BR2_LINUX_KERNEL &&  BR2_LINUX_KERNEL_CUSTOM_VERSION_VALUE = "4.9"
	help
	  realtek rtl8723b usb wifi card driver

comment "kmod_rtl8723b needs a Linux kernel to be built"
	depends on !BR2_LINUX_KERNEL
```

## chip/rts3917/sdk/rts39xx_sdk_v5.3/platform/package/driver/kmod_rtl8723cu/Config.in
```kconfig
config BR2_PACKAGE_KMOD_RTL8723CU
	bool "Realtek RTL8723C USB WiFi"
	depends on BR2_LINUX_KERNEL &&  BR2_LINUX_KERNEL_CUSTOM_VERSION_VALUE = "5.4"
	help
	  realtek rtl8723c usb wifi card driver

comment "kmod_rtl8723cu needs a Linux kernel to be built"
	depends on !BR2_LINUX_KERNEL
```

## chip/rts3917/sdk/rts39xx_sdk_v5.3/platform/package/driver/kmod_rtl8723cu_bt/Config.in
```kconfig
config BR2_PACKAGE_KMOD_RTL8723CU_BT
	bool "Realtek RTL8723CU_BT USB Bluetooth"
	depends on BR2_LINUX_KERNEL
	help
	  realtek rtl8723cu_bt usb bluetooth card driver

comment "kmod_rtl8723cu_bt needs a Linux kernel to be built"
	depends on !BR2_LINUX_KERNEL
```

## chip/rts3917/sdk/rts39xx_sdk_v5.3/platform/package/driver/kmod_rtl8723dbt/Config.in
```kconfig
config BR2_PACKAGE_KMOD_RTL8723DBT
	bool "Realtek RTL8723D USB Bluetooth"
	depends on BR2_LINUX_KERNEL
	help
	  realtek rtl8723d usb bluetooth card driver

comment "kmod_rtl8723dbt needs a Linux kernel to be built"
	depends on !BR2_LINUX_KERNEL
```

## chip/rts3917/sdk/rts39xx_sdk_v5.3/platform/package/driver/kmod_rtl8723ds/Config.in
```kconfig
config BR2_PACKAGE_KMOD_RTL8723DS
	bool "Realtek RTL8723D SDIO WiFi"
	depends on BR2_LINUX_KERNEL &&  BR2_LINUX_KERNEL_CUSTOM_VERSION_VALUE = "4.9"
	help
	  realtek rtl8723d sdio wifi card driver

comment "kmod_rtl8723ds needs a Linux kernel to be built"
	depends on !BR2_LINUX_KERNEL
```
