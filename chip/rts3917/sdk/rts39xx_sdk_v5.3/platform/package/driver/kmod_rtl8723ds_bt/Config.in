## chip/rts3917/sdk/rts39xx_sdk_v5.3/platform/package/driver/kmod_rtl8723ds_bt/Config.in
```kconfig
config BR2_PACKAGE_KMOD_RTL8723DS_BT
	bool "Realtek RTL8723D SDIO Bluetooth"
	depends on BR2_LINUX_KERNEL
	help
	  realtek rtl8723d sdio bluetooth card driver

comment "kmod_rtl8723ds_bt needs a Linux kernel to be built"
	depends on !BR2_LINUX_KERNEL
```

## chip/rts3917/sdk/rts39xx_sdk_v5.3/platform/package/driver/kmod_rtl8723du/Config.in
```kconfig
config BR2_PACKAGE_KMOD_RTL8723DU
	bool "Realtek RTL8723D USB WiFi"
	depends on BR2_LINUX_KERNEL &&  BR2_LINUX_KERNEL_CUSTOM_VERSION_VALUE = "4.9"
	help
	  realtek rtl8723d usb wifi card driver

comment "kmod_rtl8723du needs a Linux kernel to be built"
	depends on !BR2_LINUX_KERNEL
```

## chip/rts3917/sdk/rts39xx_sdk_v5.3/platform/package/driver/kmod_rtl8733bu/Config.in
```kconfig
config BR2_PACKAGE_KMOD_RTL8733BU
	bool "Realtek RTL8733B USB WiFi"
	depends on BR2_LINUX_KERNEL
	help
	  realtek rtl8733bu usb wifi card driver

comment "kmod_rtl8733bu needs a Linux kernel to be built"
	depends on !BR2_LINUX_KERNEL
```

## chip/rts3917/sdk/rts39xx_sdk_v5.3/platform/package/driver/kmod_rtl8761bt/Config.in
```kconfig
config BR2_PACKAGE_KMOD_RTL8761BT
	bool "Realtek RTL8761aw USB Bluetooth"
	depends on BR2_LINUX_KERNEL
	help
	  realtek rtl8761aw usb bluetooth card driver

comment "kmod_rtl8761aw needs a Linux kernel to be built"
	depends on !BR2_LINUX_KERNEL
```

## chip/rts3917/sdk/rts39xx_sdk_v5.3/platform/package/driver/kmod_rtl8821cu/Config.in
```kconfig
config BR2_PACKAGE_KMOD_RTL8821CU
	bool "Realtek RTL8821C&RTL8811C USB WiFi"
	depends on BR2_LINUX_KERNEL
	help
	  realtek rtl8821c&rtl8811cu usb wifi card driver

comment "kmod_rtl8821c needs a Linux kernel to be built"
	depends on !BR2_LINUX_KERNEL
```

## chip/rts3917/sdk/rts39xx_sdk_v5.3/platform/package/driver/kmod_rtl8821cu_bt/Config.in
```kconfig
config BR2_PACKAGE_KMOD_RTL8821CU_BT
	bool "Realtek RTL8821cu USB Bluetooth"
	depends on BR2_LINUX_KERNEL
	help
	  realtek rtl8821cu usb bluetooth card driver

comment "kmod_rtl8821cu needs a Linux kernel to be built"
	depends on !BR2_LINUX_KERNEL
```

## chip/rts3917/sdk/rts39xx_sdk_v5.3/platform/package/driver/kmod_rtl8822cs/Config.in
```kconfig
config BR2_PACKAGE_KMOD_RTL8822CS
	bool "Realtek RTL8822C SDIO WiFi"
	depends on BR2_LINUX_KERNEL &&  BR2_LINUX_KERNEL_CUSTOM_VERSION_VALUE = "4.9"
	help
	  realtek rtl8822c sdio wifi card driver

comment "kmod_rtl8822cs needs a Linux kernel to be built"
	depends on !BR2_LINUX_KERNEL
```

## chip/rts3917/sdk/rts39xx_sdk_v5.3/platform/package/driver/kmod_rtl8822cs_bt/Config.in
```kconfig
config BR2_PACKAGE_KMOD_RTL8822CS_BT
	bool "Realtek RTL8822C SDIO Bluetooth"
	depends on BR2_LINUX_KERNEL
	help
	  realtek rtl8822c sdio bluetooth card driver

comment "kmod_rtl8822cs_bt needs a Linux kernel to be built"
	depends on !BR2_LINUX_KERNEL
```

## chip/rts3917/sdk/rts39xx_sdk_v5.3/platform/package/driver/kmod_rtl8822cu/Config.in
```kconfig
config BR2_PACKAGE_KMOD_RTL8822CU
	bool "Realtek RTL8822CU USB WiFi"
	depends on BR2_LINUX_KERNEL
	help
	  realtek rtl8822cu usb wifi card driver

comment "kmod_rtl8822cu needs a Linux kernel to be built"
	depends on !BR2_LINUX_KERNEL
```

## chip/rts3917/sdk/rts39xx_sdk_v5.3/platform/package/driver/kmod_rtl8822cu_bt/Config.in
```kconfig
config BR2_PACKAGE_KMOD_RTL8822CU_BT
	bool "Realtek RTL8822CU_BT USB Bluetooth"
	depends on BR2_LINUX_KERNEL
	help
	  realtek rtl8822cu_bt usb bluetooth card driver

comment "kmod_rtl8822cu_bt needs a Linux kernel to be built"
	depends on !BR2_LINUX_KERNEL
```

## chip/rts3917/sdk/rts39xx_sdk_v5.3/platform/package/driver/kmod_rtl8830au/Config.in
```kconfig
config BR2_PACKAGE_KMOD_RTL8830AU
	bool "Realtek RTL8830AU USB WiFi"
	depends on BR2_LINUX_KERNEL
	help
	  realtek rtl8830au usb wifi card driver

comment "kmod_rtl8830au needs a Linux kernel to be built"
	depends on !BR2_LINUX_KERNEL
```

## chip/rts3917/sdk/rts39xx_sdk_v5.3/platform/package/driver/kmod_rtl8852bu/Config.in
```kconfig
config BR2_PACKAGE_KMOD_RTL8852BU
	bool "Realtek RTL8852B USB WiFi"
	depends on BR2_LINUX_KERNEL
	help
	  realtek rtl8852bu usb wifi card driver

comment "kmod_rtl8852bu needs a Linux kernel to be built"
	depends on !BR2_LINUX_KERNEL
```

## chip/rts3917/sdk/rts39xx_sdk_v5.3/platform/package/driver/kmod_rtl88x2bu/Config.in
```kconfig
config BR2_PACKAGE_KMOD_RTL88X2BU
	bool "Realtek RTL88X2B USB WiFi"
	depends on BR2_LINUX_KERNEL &&  BR2_LINUX_KERNEL_CUSTOM_VERSION_VALUE = "4.9"
	help
	  realtek rtl88x2b &rtl8822c usb wifi card driver

comment "kmod_rtl88x2bu needs a Linux kernel to be built"
	depends on !BR2_LINUX_KERNEL
```

## chip/rts3917/sdk/rts39xx_sdk_v5.3/platform/package/lib/Config.in
```kconfig
menu "Libraries"

source "$BR2_EXTERNAL_platform_PATH/package/lib/libsysconf/Config.in"
source "$BR2_EXTERNAL_platform_PATH/package/lib/luaunit/Config.in"
source "$BR2_EXTERNAL_platform_PATH/package/lib/libwebsockets3/Config.in"
source "$BR2_EXTERNAL_platform_PATH/package/lib/libkcapi1/Config.in"
source "$BR2_EXTERNAL_platform_PATH/package/lib/libfsmgr/Config.in"
source "$BR2_EXTERNAL_platform_PATH/package/lib/usrsctp/Config.in"

endmenu
```

## chip/rts3917/sdk/rts39xx_sdk_v5.3/platform/package/lib/libfsmgr/Config.in
```kconfig
config BR2_PACKAGE_LIBFSMGR
	bool "libfsmgr"
	default n
	select BR2_PACKAGE_LIBKCAPI1
	select BR2_PACKAGE_MTD
```

## chip/rts3917/sdk/rts39xx_sdk_v5.3/platform/package/lib/libkcapi1/Config.in
```kconfig
config BR2_PACKAGE_LIBKCAPI1
	bool "libkcapi-1.2.0"
	default n
	help
	  Linux Kernel Crypto API User Space Interface library.

	  http://www.chronox.de/libkcapi.html

if BR2_PACKAGE_LIBKCAPI1

config BR2_PACKAGE_LIBKCAPI1_APPS
	bool "build test applications"
	depends on BR2_USE_MMU # fork()
	help
	  Build additional test applications that can provide
	  performance or algorithm tests.

endif
```

## chip/rts3917/sdk/rts39xx_sdk_v5.3/platform/package/lib/libsysconf/Config.in
```kconfig
config BR2_PACKAGE_LIBSYSCONF
	bool "libsysconf"
	select BR2_PACKAGE_JSON_C
	default n
	help
	  library for conf file

config BR2_PACKAGE_LIBSYSCONF_UNIT_TEST
	bool "libsysconf unit test"
	depends on BR2_PACKAGE_LIBSYSCONF
	select BR2_PACKAGE_CUNIT
	default n
	help
	  unit test for libsysconf
```

## chip/rts3917/sdk/rts39xx_sdk_v5.3/platform/package/lib/libwebsockets3/Config.in
```kconfig
config BR2_PACKAGE_LIBWEBSOCKETS3
	bool "libwebsockets-v3.2.0"
	depends on BR2_USE_MMU # fork()
	select BR2_PACKAGE_ZLIB
	help
	  Libwebsockets is a lightweight pure C library built to use
	  minimal CPU and memory resources, and provide fast throughput
	  in both directions.

	  Please note THAT: the default version of libwebsocket in buildroot is v2.2.1

	  http://libwebsockets.org/
```

## chip/rts3917/sdk/rts39xx_sdk_v5.3/platform/package/lib/luaunit/Config.in
```kconfig
config BR2_PACKAGE_LUAUNIT
	bool "luaunit"
	depends on BR2_PACKAGE_LUA_5_1 || BR2_PACKAGE_LUAJIT
	help
	  Another lua unit test framework

	  https://github.com/bluebird75/luaunit
```

## chip/rts3917/sdk/rts39xx_sdk_v5.3/platform/package/lib/usrsctp/Config.in
```kconfig
config BR2_PACKAGE_USRSCTP
	bool "usrsctp"
	help
	  This is a userland SCTP stack supporting FreeBSD, OpenBSD, Linux, Mac OS X and Windows.

	  https://github.com/sctplab/usrsctp
```

## chip/rts3917/sdk/rts39xx_sdk_v5.3/platform/package/rtscore/Config.in
```kconfig
menu "RTS Core Libraries"

source "$BR2_EXTERNAL_platform_PATH/package/rtscore/isp_algo/Config.in"
source "$BR2_EXTERNAL_platform_PATH/package/rtscore/cmos_sensor/Config.in"

source "$BR2_EXTERNAL_platform_PATH/package/rtscore/rtstream/Config.in"
source "$BR2_EXTERNAL_platform_PATH/package/rtscore/librtsio/Config.in"
source "$BR2_EXTERNAL_platform_PATH/package/rtscore/librtscrypt/Config.in"

config BR2_PACKAGE_3RDPARTY
	tristate "3rdparty"
	default n
	help
	  Binary libraries from 3td party

if BR2_PACKAGE_3RDPARTY
endif

source "$BR2_EXTERNAL_platform_PATH/package/rtscore/rts_sample/Config.in"


config BR2_PACKAGE_NNSOLU
	tristate "NN Solution"
	default n
	help
	  NN Solution packages

if BR2_PACKAGE_NNSOLU
endif

source "$BR2_EXTERNAL_platform_PATH/package/rtscore/cv_app/Config.in"


endmenu
```

## chip/rts3917/sdk/rts39xx_sdk_v5.3/platform/package/rtscore/cmos_sensor/Config.in
```kconfig
config BR2_PACKAGE_CMOS_SENSOR
	bool "cmos sensors for isp"
	depends on BR2_PACKAGE_LIBRTSISP
	depends on BR2_CONFIG_HW_VER_RTS3915 || BR2_CONFIG_HW_VER_RTS3917
	default y
	help
	  Realtek cmos sensors support for isp

if BR2_PACKAGE_CMOS_SENSOR

config BR2_PACKAGE_CMOS_SENSOR_LIST
	string "Supported sensors list"
	default ""
	help
	  Sensors which need to be installed to rootfs

endif
```

## chip/rts3917/sdk/rts39xx_sdk_v5.3/platform/package/rtscore/cv_app/Config.in
```kconfig
config BR2_PACKAGE_CV_APP
	bool "cv_app"
	default n
	help
	  Realtek cv algorithm

if BR2_PACKAGE_CV_APP

config BR2_PACKAGE_CV_PANORAMA
	bool "library panorama"
	default n
	help
	  Realtek algorithm of panorama

config BR2_PACKAGE_CV_MOTION_TRACKING
	bool "library motion_tracking"
	default n
	help
	  Realtek algorithm of motion tracking

config BR2_PACKAGE_CV_RTSMD
	select BR2_PACKAGE_RTSTREAM
	select BR2_PACKAGE_RTSTREAM_VIDEO
	bool "library rtsmd"
	default n
	help
	  Realtek algorithm of motion detection

config BR2_PACKAGE_CV_RTSAVD
	select BR2_PACKAGE_RTSTREAM
	select BR2_PACKAGE_RTSTREAM_VIDEO
	bool "library rtsavd"
	default n
	help
	  Realtek algorithm  for abnormal video diagnosis

config BR2_CV_APP_CIPHER_EN
	bool "cv app cipher enable"
	default n
	help
	  Enable cipher protection for algorithm


endif
```

## chip/rts3917/sdk/rts39xx_sdk_v5.3/platform/package/rtscore/isp_algo/Config.in
```kconfig
config BR2_PACKAGE_ISP_ALGO
	bool "isp algorithm"
	depends on BR2_PACKAGE_LIBRTSISP
	depends on BR2_CONFIG_HW_VER_RTS3915 || BR2_CONFIG_HW_VER_RTS3917
	default n
	help
	  Realtek algorithm for isp

if BR2_PACKAGE_ISP_ALGO
config BR2_PACKAGE_ISP_ALGO_AE
	bool "rts isp ae algorithm support"
    default y

config BR2_PACKAGE_ISP_ALGO_AWB
	bool "rts isp awb algorithm support"
    default y

config BR2_PACKAGE_ISP_ALGO_AF
	bool "rts isp af algorithm support"
    default y
endif
```

## chip/rts3917/sdk/rts39xx_sdk_v5.3/platform/package/rtscore/librtscrypt/Config.in
```kconfig
config BR2_PACKAGE_LIBRTSCRYPT
	bool "librtscrypt"
	default y
	help
	  librtscrypt library
```
