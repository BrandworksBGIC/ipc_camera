## chip/rts3917/sdk/rts39xx_sdk_v5.3/platform/package/rtscore/librtsio/Config.in
```kconfig
config BR2_PACKAGE_LIBRTSIO
	bool "librtsio"
	default n
	help
	  librtsio library
```

## chip/rts3917/sdk/rts39xx_sdk_v5.3/platform/package/rtscore/rts_sample/Config.in
```kconfig
config BR2_PACKAGE_RTS_SAMPLE
	bool "sample"
	default n
	help
	  sample for rtscore

if BR2_PACKAGE_RTS_SAMPLE

config BR2_PACKAGE_RTS_SAMPLE_RTSTREAM_AUDIO
	bool "rtstream audio sample"
	select BR2_PACKAGE_RTSTREAM
	default y
	help
	  rtstream audio sample

config BR2_PACKAGE_RTS_SAMPLE_RTSTREAM_VIDEO
	bool "rtstream video sample"
	select BR2_PACKAGE_LIBRTSMCU if !BR2_CONFIG_HW_VER_RTS3915 && !BR2_CONFIG_HW_VER_RTS3917
	select BR2_PACKAGE_LIBRTSIO if !BR2_CONFIG_HW_VER_RTS3915 && !BR2_CONFIG_HW_VER_RTS3917
	select BR2_PACKAGE_RTSTREAM
	select BR2_PACKAGE_RTSTREAM_VIDEO
	select BR2_PACKAGE_RTSTREAM_H26X
	select BR2_PACKAGE_RTSTREAM_MJPEG
	default y
	help
	  rtstream video sample

config BR2_PACKAGE_RTS_SAMPLE_RTSSED
	bool "rtssed sample"
	select BR2_PACKAGE_REALVOICE
	select BR2_PACKAGE_RTSSED
	default n
	help
	  rtssed sample

config BR2_PACKAGE_RTS_SAMPLE_RTSAAC
	bool "rtsaac sample"
	select BR2_PACKAGE_VO_AACENC
	default n
	help
	  rtsaac sample

config BR2_PACKAGE_RTS_SAMPLE_RTSMP3
	bool "rtsmp3 sample"
	select BR2_PACKAGE_ALURE
	select BR2_PACKAGE_ALURE_MINIMP3_DECODER
	default n
	help
	  rtsmp3 sample

config BR2_PACKAGE_RTS_SAMPLE_LIBRTSIO
	bool "librtsio sample"
	select BR2_PACKAGE_LIBRTSIO
	default y
	help
	  librtsio sample

config BR2_PACKAGE_RTS_SAMPLE_LIBRTSCRYPT
	bool "librtscrypt sample"
	select BR2_PACKAGE_LIBRTSCRYPT
	default y
	help
	  librtscrypt sample

choice
        prompt "Selected library format"
	default BR2_PACKAGE_RTS_SAMPLE_SHARE

config BR2_PACKAGE_RTS_SAMPLE_SHARE
        bool "dynamic library"
        help
          sample using dynamic library.

config BR2_PACKAGE_RTS_SAMPLE_STATIC
        bool "static library"
        help
          sample using static library.

endchoice
endif
```

## chip/rts3917/sdk/rts39xx_sdk_v5.3/platform/package/rtscore/rtstream/Config.in
```kconfig
config BR2_PACKAGE_RTSTREAM
	bool "rtstream"
	default n
	help
	  Realtek Stream Lib

if BR2_PACKAGE_RTSTREAM

config BR2_PACKAGE_RTSTREAM_VIDEO
	bool "rtstream video support"
	select BR2_PACKAGE_LIBRTSMCU if BR2_CONFIG_HW_VER_RTS3903 || BR2_CONFIG_HW_VER_RTS3913
	select BR2_PACKAGE_LIBRTSISP if BR2_CONFIG_HW_VER_RTS3915 || BR2_CONFIG_HW_VER_RTS3917
	default y

if BR2_PACKAGE_RTSTREAM_VIDEO

config BR2_PACKAGE_LIBRTSMCU
	bool "librtsmcu"
	select BR2_LINUX_KERNEL
	depends on BR2_CONFIG_HW_VER_RTS3903 || BR2_CONFIG_HW_VER_RTS3913
	default n
	help
	  Realtek mcu lib

config BR2_PACKAGE_LIBRTSISP
	bool "librtsisp"
	select BR2_PACKAGE_ISP_ALGO
	select BR2_LINUX_KERNEL
	depends on BR2_CONFIG_HW_VER_RTS3915 || BR2_CONFIG_HW_VER_RTS3917
	default n
	help
	  Realtek isp library

if BR2_PACKAGE_LIBRTSISP

config BR2_PACKAGE_LIBRTSISP_UNIT_TEST
	bool "ISP unit test enable"
	select BR2_PACKAGE_CHECK
	default n
	help
	  ISP unit test

endif

config BR2_PACKAGE_RTSTREAM_H26X
	bool "rtstream h26x"
	default n
	help
	  Realtek Stream H265/H264 Lib

if BR2_PACKAGE_RTSTREAM_H26X
choice
	prompt "Selected h26x lib"
config BR2_PACKAGE_H1_ENCODER
	bool "h1 H264 encoder"
	select BR2_LINUX_KERNEL
	depends on BR2_CONFIG_HW_VER_RTS3903 || BR2_PACKAGE_FREE_IC
	help
	  H264 encoder, for h264 stream

config BR2_PACKAGE_WAVE420
	bool "h265 encoder library"
	select BR2_LINUX_KERNEL
	depends on BR2_CONFIG_HW_VER_RTS3913 || BR2_PACKAGE_FREE_IC

config BR2_PACKAGE_WAVE521
	bool "h265&h264 encoder library"
	select BR2_LINUX_KERNEL
	depends on BR2_CONFIG_HW_VER_RTS3915 || BR2_CONFIG_HW_VER_RTS3917 || BR2_PACKAGE_FREE_IC

endchoice

if BR2_PACKAGE_H1_ENCODER
config BR2_DLOPEN_H1_ENCODER
	bool "dlopen h264 library"
	default n
	help
	  dlopen h264 encoder library for Realtek rts3903
endif

if BR2_PACKAGE_WAVE420
config BR2_DLOPEN_WAVE420
	bool "dlopen h265 library"
	default n
	help
	  dlopen h265 encoder library for Realtek rts3913
endif

if BR2_PACKAGE_WAVE521
config BR2_DLOPEN_WAVE521
	bool
	default n
	help
	  dlopen h265&h264 encoder library for Realtek rts3915 or rts3917

config BR2_WAVE521_RLE0849
	bool
	default n

config BR2_WAVE521_RTS3917
	bool
	default y
endif

endif

config BR2_PACKAGE_RTSTREAM_MJPEG
	bool "rtstream mjpeg"
	default n
	help
	  Realtek Stream MJPEG Lib

if BR2_PACKAGE_RTSTREAM_MJPEG
choice
	prompt "Selected mjpeg lib"
config BR2_PACKAGE_CODAJ12
	bool "mjpeg codec library"
	select BR2_LINUX_KERNEL
	depends on BR2_CONFIG_HW_VER_RTS3915 || BR2_PACKAGE_FREE_IC
	help
	  mjpeg codec library for Realtek RTS3915

config BR2_PACKAGE_RTSTREAM_JPEG
	bool "rtstream mjpeg library for rts3917"
	select BR2_LINUX_KERNEL
	depends on BR2_CONFIG_HW_VER_RTS3917 || BR2_PACKAGE_FREE_IC
	help
	  mjpeg for Realtek RTS3917
endchoice

if BR2_PACKAGE_CODAJ12
config BR2_DLOPEN_CODAJ12
	bool "dlopen mjpeg codec library"
	default n
	help
	  dlopen mjpeg codec library for Realtek rts3915
endif

endif

config BR2_PACKAGE_RTSTREAM_OSD2_HW
	bool

config BR2_PACKAGE_RTSTREAM_OSD2
	bool "rtstream osd2 support"
	select BR2_LINUX_KERNEL
	select BR2_PACKAGE_RTSTREAM_OSD2_HW
	default y

config BR2_PACKAGE_RTSTREAM_OSDI
	bool "rtstream osdi support"
	depends on BR2_CONFIG_HW_VER_RTS3917
	default y

config BR2_PACKAGE_RTSTREAM_MTD2
	bool "rtstream mtd2 support"
	depends on BR2_CONFIG_HW_VER_RTS3915 || BR2_CONFIG_HW_VER_RTS3917
	default y

config BR2_PACKAGE_RTSTREAM_VIDEO_OUT
	bool "rtstream video out support"
	depends on BR2_CONFIG_HW_VER_RTS3915
	default y

endif

config BR2_PACKAGE_RTSTREAM_AUDIO
	bool "rtstream audio support"
	select BR2_PACKAGE_ALSA_LIB
	select BR2_PACKAGE_LIBSOXR
	default y

if BR2_PACKAGE_RTSTREAM_AUDIO
config BR2_PACKAGE_RTSTREAM_AUDIO_AEC
	bool "rtstream audio aec support"
	select BR2_PACKAGE_3RDPARTY
	default y
	help
	  enable aec & ns when audio capture

config BR2_PACKAGE_RTSTREAM_RTS_EQ_CORE_LIB
	bool "rtstream rts_eq_core library"
	default n
	help
	  Y to generate rts_eq_core dynamic library
endif

config BR2_PACKAGE_FREE_IC
	bool "rtstream no check chip model"
	default n
	help
	  Y to cancel restriction to chip model

endif
```

## chip/rts3917/sdk/rts39xx_sdk_v5.3/platform/package/system/Config.in
```kconfig
menu "System packages"

source "$BR2_EXTERNAL_platform_PATH/package/system/gaia/Config.in"
source "$BR2_EXTERNAL_platform_PATH/package/system/rainbow/Config.in"
source "$BR2_EXTERNAL_platform_PATH/package/system/otp_mfg/Config.in"
source "$BR2_EXTERNAL_platform_PATH/package/system/neuralyzer/Config.in"
source "$BR2_EXTERNAL_platform_PATH/package/system/rtskey/Config.in"
source "$BR2_EXTERNAL_platform_PATH/package/system/ota_upfw/Config.in"

endmenu
```

## chip/rts3917/sdk/rts39xx_sdk_v5.3/platform/package/system/gaia/Config.in
```kconfig
config BR2_PACKAGE_GAIA
	bool "gaia"
	default y
	select BR2_PACKAGE_JSON_C if BR2_CONFIG_HW_VER_RTS3915 || BR2_CONFIG_HW_VER_RTS3917
	select BR2_PACKAGE_RTSTREAM if BR2_CONFIG_HW_VER_RTS3915 || BR2_CONFIG_HW_VER_RTS3917
	help
	  gaia

config BR2_PACKAGE_GAIA_FAST
	bool "fast gaia"
	default n
	depends on BR2_PACKAGE_GAIA
	help
	  gaia will not parse json to obtain sensor information

config BR2_PACKAGE_GAIA_FAST_SENSOR
	string "Supported sensor of fast gaia"
	default "sc3235"
	depends on BR2_PACKAGE_GAIA_FAST
	help
	  Sensor which fast gaia supported
```

## chip/rts3917/sdk/rts39xx_sdk_v5.3/platform/package/system/neuralyzer/Config.in
```kconfig
config BR2_PACKAGE_NEURALYZER
	bool "neuralyzer"
	default n
	select BR2_PACKAGE_MTD
	help
	  Image update tool
```

## chip/rts3917/sdk/rts39xx_sdk_v5.3/platform/package/system/ota_upfw/Config.in
```kconfig
config BR2_PACKAGE_OTA_UPFW
	bool "OTA update fw"
	default n
	help
	  ota,support rauc and swupdate

if BR2_PACKAGE_OTA_UPFW

choice
	prompt "Selected update method to use"
	default BR2_PACKAGE_RAUC_UPFW

	config BR2_PACKAGE_RAUC_UPFW
		bool "rauc_upfw"
		select BR2_PACKAGE_RAUC
		select BR2_PACKAGE_RAUC_JSON
		help
			system packages module

	config BR2_PACKAGE_SWU_UPFW
		bool "swupdate_upfw"
		select BR2_PACKAGE_SWUPDATE
		select BR2_PACKAGE_CPIO
		help
			system packages module
endchoice

endif
```

## chip/rts3917/sdk/rts39xx_sdk_v5.3/platform/package/system/otp_mfg/Config.in
```kconfig
config BR2_PACKAGE_OTP_MFG
	bool "otp_mfg"
	default n
	help
	  otp manufacturer tools
```

## chip/rts3917/sdk/rts39xx_sdk_v5.3/platform/package/system/rainbow/Config.in
```kconfig
config BR2_PACKAGE_RAINBOW
	bool "rainbow"
	select BR2_PACKAGE_RTSTREAM
	select BR2_PACKAGE_RTSTREAM_VIDEO
	select BR2_PACKAGE_RTSTREAM_AUDIO
	select BR2_PACKAGE_LIVE555
	select BR2_PACKAGE_UBUS
	select BR2_PACKAGE_RTSTREAM_H26X
	select BR2_PACKAGE_RTSTREAM_MJPEG
	select BR2_PACKAGE_RTSTREAM_OSDI
	select BR2_PACKAGE_JSON_C
	select BR2_PACKAGE_LIBRTSMCU if BR2_CONFIG_HW_VER_RTS3903 || BR2_CONFIG_HW_VER_RTS3913
	default n
	help
	  reference design
```

## chip/rts3917/sdk/rts39xx_sdk_v5.3/platform/package/system/rtskey/Config.in
```kconfig
menuconfig BR2_PACKAGE_RTSKEY
	bool "rtskey"
	depends on BR2_CONFIG_SECURE_BOOT || BR2_CONFIG_CRYPTO_BOOT
	default n
	help
	  A suite to generate keys and stuffs for crypto & secure boot.

	config BR2_RTSKEY_OUT_DIR
		string "rtskey output directory"
		depends on BR2_PACKAGE_RTSKEY
		default "$(BASE_DIR)/rtskey"
		help
		  The directory where the keys are generated on the host.
		  Note: the keys in this directory need to be kept safe in case they
		  are lost.

	config BR2_RTSKEY_TARGET_DIR
		string "keys target directory"
		depends on BR2_PACKAGE_RTSKEY
		default "/etc/keys"
		help
		  The directory where the keys are stored on the board.

	config BR2_CRYPTO_BOOT_KEY
		string "crypto boot key name"
		depends on BR2_PACKAGE_RTSKEY && BR2_CONFIG_CRYPTO_BOOT
		default "crypto_key"
		help
		  The key used to encrypt the kernel. In FDE mode, also used to
		  encrypt rootfs and user partitions(if supported).

	config BR2_CRYPTO_BOOT_IV
		string "crypto boot iv name"
		depends on BR2_PACKAGE_RTSKEY && BR2_CONFIG_CRYPTO_BOOT
		default "crypto_iv"

	config BR2_SECURE_ROOT_KEY
		string "root key name"
		depends on BR2_PACKAGE_RTSKEY && BR2_CONFIG_SECURE_BOOT
		default "verity_key0"
		help
		  The root key of the CoT(chain of trusted). Used for bootrom
		  to verify uboot.

	config BR2_SECURE_KERNEL_KEY
		string "kernel key name"
		depends on BR2_PACKAGE_RTSKEY && BR2_CONFIG_SECURE_BOOT
		default "verity_key1"
		help
		  Used for uboot verify kernel.

	config BR2_SECURE_DATA_KEY
		string "data key name"
		depends on BR2_PACKAGE_RTSKEY && BR2_CONFIG_SECURE_BOOT
		default "verity_key2"
		help
		  In dm-verity mode, used for kernel verify rootfs. In ubifs
		  authentication mode, the key is set to CONFIG_SYSTEM_TRUSTED_KEYS,
		  and used for kernel verify rootfs and user partitions, and only
		  used when the partition is mounted for the first time.

	config BR2_CRYPTO_FBE_KEY
		string "FBE key name"
		depends on BR2_PACKAGE_RTSKEY && BR2_CONFIG_FILE_BASED_ENCRYPTION
		default "fbe_key"
		help
		  In FBE mode, used to encrypt rootfs and user partitions.

	config BR2_SECURE_UBIFS_AUTH_KEY
		string "ubifs authentication key name"
		depends on BR2_PACKAGE_RTSKEY && BR2_CONFIG_UBIFS_FS_AUTHENTICATION
		default "ubifs_auth_key"
		help
		  After the partition is mounted for the first time, the ubifs
		  authentication is converted to HMAC mode. This key is used for
		  HMAC.
```

## chip/rts3917/sdk/rts39xx_sdk_v5.3/platform/package/usb/Config.in
```kconfig
menu "Usb packages"

source "$BR2_EXTERNAL_platform_PATH/package/usb/pfigure/Config.in"
source "$BR2_EXTERNAL_platform_PATH/package/usb/usb_multi/Config.in"
source "$BR2_EXTERNAL_platform_PATH/package/usb/uvca/Config.in"

endmenu
```

## chip/rts3917/sdk/rts39xx_sdk_v5.3/platform/package/usb/pfigure/Config.in
```kconfig
menu "PFigure"

config BR2_PACKAGE_PFIGURE
	bool "pfigure application"
	select BR2_PACKAGE_RTSTREAM
	select BR2_PACKAGE_RTSTREAM_MJPEG
	select BR2_PACKAGE_JPEG
	select BR2_PACKAGE_LIBJPEG
	select BR2_PACKAGE_REALNET
	default n
	help
	  Realtek figure parse

if BR2_PACKAGE_PFIGURE

config BR2_PACKAGE_PFIGURE_PLUGIN_OD
    bool "plugin od"
    select BR2_PACKAGE_REALNET
    select BR2_PACKAGE_REALNET_OD
    default n
    help
        Realtek object detection pfigure plugin

endif

endmenu
```

## chip/rts3917/sdk/rts39xx_sdk_v5.3/platform/package/usb/usb_multi/Config.in
```kconfig
config BR2_PACKAGE_USB_MULTI
	tristate "usb multi function"
	default n
	help
	  usb multiple function,include uvcd/uacd/dfud

config BR2_PACKAGE_CONFIGFS
	bool "config by configfs"
	depends on BR2_PACKAGE_USB_MULTI
	default n
	help
	  support config usb multipile function by configfs

config BR2_PACKAGE_UVCD
	tristate "uvcd"
	depends on BR2_PACKAGE_USB_MULTI
	select BR2_PACKAGE_RTSTREAM
	select BR2_PACKAGE_RTSTREAM_VIDEO
	select BR2_PACKAGE_RTSTREAM_MJPEG
	select BR2_PACKAGE_UBUS
	select BR2_PACKAGE_JSON_C
	select BR2_PACKAGE_REALBOX
	select BR2_PACKAGE_RTSAEZOOM
	default n
	help
	  support uvc preview
choice
	prompt "uvc version"
	depends on BR2_PACKAGE_UVCD
config BR2_PACKAGE_UVCD_UVC_11
	bool "UVC 1.1"
config BR2_PACKAGE_UVCD_UVC_15
	bool "UVC 1.5"
endchoice

config BR2_PACKAGE_UVCD_H264
	bool "Support H.264"
	depends on BR2_PACKAGE_UVCD
	select BR2_PACKAGE_RTSTREAM_H26X
	default n
	help
	  support h.264 format

config BR2_PACKAGE_UVCD_H265
	bool "Support H.265"
	depends on BR2_PACKAGE_UVCD
	depends on BR2_PACKAGE_UVCD_UVC_11
	select BR2_PACKAGE_RTSTREAM_H26X
	default n
	help
	  support h.265 format

config BR2_PACKAGE_NNE
	bool "nn event notify"
	depends on BR2_PACKAGE_UVCD
	default n
	help
	  transfer nn event meta data to host.

config BR2_PACKAGE_OSD_SUPPRT
	bool "osd support"
	depends on BR2_PACKAGE_UVCD
	select BR2_PACKAGE_RTSTREAM_OSDI
	select BR2_PACKAGE_FREETYPE
	default n
	help
	  support osd.

config BR2_PACKAGE_NOTIFY_BY_ACM
	bool "notify by ACM"
	depends on BR2_PACKAGE_NNE
	default n
	help
	  transfer data to host by ACM.

config BR2_PACKAGE_UVCD_SAMPLE
	bool "uvcd sample"
	depends on BR2_PACKAGE_UVCD
	default n
	help
	  UVCD sample code

config BR2_PACKAGE_UVCD_ZOOM
	bool "Support ZOOM"
	depends on BR2_PACKAGE_UVCD
	depends on BR2_CONFIG_HW_VER_RTS3917
	default n
	help
	  support zoom

config BR2_PACKAGE_SENSOR_ROLL
	int "Sensor Roll Setting"
	depends on BR2_PACKAGE_UVCD
	range 0 3
	default 0
	help
	  Sensor roll setting

config BR2_PACKAGE_UVCD_METADATA_TEST
        bool "Support metadata test"
        depends on BR2_PACKAGE_UVCD
        default n
        help
          support metadata test

config BR2_PACKAGE_UACD
	bool "uacd"
	select BR2_PACKAGE_ALSA_LIB
	default n
	help
	  transfer data between uac and rlx internal sound card.

config BR2_PACKAGE_DFUD
	bool "dfud"
	depends on BR2_PACKAGE_USB_MULTI
	select BR2_PACKAGE_MTD
	default n
	help
	  support device firmware update

config BR2_PACKAGE_CHGROOT
	bool "chgroot support"
	depends on BR2_PACKAGE_DFUD
	default y

config BR2_PACKAGE_SEAMLESS_UBOOT_DFU
	bool "seamless uboot dfu support"
	depends on BR2_PACKAGE_DFUD
	default n
```

## chip/rts3917/sdk/rts39xx_sdk_v5.3/platform/package/usb/uvca/Config.in
```kconfig
config BR2_PACKAGE_UVCA
	bool "uvca"
	select BR2_PACKAGE_LIBSYSCONF
	select BR2_PACKAGE_RTSTREAM
	select BR2_PACKAGE_NNSOLU
	select BR2_PACKAGE_REALNET
	select BR2_PACKAGE_REALNET_OD_TINY
	select BR2_PACKAGE_UBUS
	select BR2_PACKAGE_REALBOX
	select BR2_PACKAGE_RTSMOT
	depends on BR2_PACKAGE_UVCD
	default n
	help
	  a daemon do nn jobs and send metadata via serial
```

## chip/rts3917/sdk/rts39xx_sdk_v5.3/platform/source/bootloader/uboot-2023.01/board/realtek/Kconfig
```kconfig
#
# u-Boot
#

config SYS_VENDOR
	default "realtek"

config SYS_BOARD
	default "rlxboard"

config SYS_CONFIG_NAME
	default "rlxboard"

# config SYS_TEXT_BASE
# 	default "0x82800000"
```
