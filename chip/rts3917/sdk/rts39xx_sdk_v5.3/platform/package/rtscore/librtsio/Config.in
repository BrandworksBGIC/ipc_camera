## chip/rts3917/sdk/rts39xx_sdk_v5.3/platform/source/bootloader/uboot-2023.01/board/realtek/Kconfig.board
```kconfig
if BOARD_RTS3917
source "board/realtek/rts3917/Kconfig"
endif
if BOARD_RTS3921
source "board/realtek/rts3921/Kconfig"
endif
```

## chip/rts3917/sdk/rts39xx_sdk_v5.3/platform/source/bootloader/uboot-2023.01/board/realtek/Kconfig.soc
```kconfig
#
# Realtek Semiconductor Corp.
#
# Tony Wu (tonywu@realtek.com)
# Dec. 7, 2009
#

#
# SoC System Config
#
config SOC_PLATFORM
	string
	default "sheipa"

config SOC_SHEIPA
	bool
	default y
	select SOC_SUPPORT_ARMA7
	select SOC_SUPPORT_ARMA12
	select SOC_SUPPORT_ARMA15
	select SOC_SUPPORT_ARMA17
	select SOC_SUPPORT_ARMA32
	select SOC_SUPPORT_ARMA53
	select SOC_SUPPORT_ARMA57
	select SOC_SUPPORT_ARMA57_A53
	select SOC_SUPPORT_ARMA55
	select SOC_SUPPORT_ARMA75_A55
	select SOC_SUPPORT_SMP
	select SOC_SUPPORT_PCI
	select SOC_SUPPORT_USB
	select SOC_SUPPORT_L2C
	select SOC_CPU_ARM
	select SOC_SUPPORT_ANDROID
	select SOC_SUPPORT_FLASH
```

## chip/rts3917/sdk/rts39xx_sdk_v5.3/platform/source/bootloader/uboot-2023.01/board/realtek/rts3921/Kconfig
```kconfig
choice
	prompt "DDR Type Selection"
	default RTS3921_BGA240_DDR3_GENERAL
	help
	  Select ddr type

config RTS3921_QFN88_DDR2_512MBIT
	bool "QFN88 DDR2 MCM(512Mbit)"
	depends on (TARGET_ASIC || TARGET_EMULATOR)
	select QFN88_PACKAGE
	help
	 Enable option for QFN88 DDR2 512Mbit

config RTS3921_BGA173_DDR2_512MBIT
	bool "BGA173 DDR2 MCM(512Mbit)"
	depends on (TARGET_ASIC || TARGET_EMULATOR)
	help
	  Enable option for BGA173 DDR2 512Mbit

config RTS3921_QFN88_DDR3_1GBIT
	bool "QFN88 DDR3 MCM(1Gbit)"
	depends on (TARGET_ASIC || TARGET_EMULATOR)
	select QFN88_PACKAGE
	help
	 Enable option for QFN88 DDR3 1Gbit

config RTS3921_BGA240_DDR3_GENERAL
	bool "BGA240 DDR3 External"
	depends on (BOARD_RTS3921 && !TARGET_FPGA)
	help
	  Enable option for 1Gbit or 2Gbit DDR on demo board

config RTS3921_DDR_H5TQ2G
	bool "DDR3 H5TQ2G(Hynix 256MB)"
	depends on TARGET_FPGA
	help
	  Enable option for DDR H5TQ2G
endchoice

choice
	prompt "DDR Speed Selection"
	default RTS3921_DDR_1066
	depends on  (TARGET_ASIC || TARGET_EMULATOR)
	help
	  Select ddr clock

config RTS3921_DDR_800
	bool "DDR-800"
	depends on (RTS3921_QFN88_DDR2_512MBIT || RTS3921_BGA173_DDR2_512MBIT)
	help
	  Select ddr dqs clock to 800/2

config RTS3921_DDR_1066
	bool "DDR-1066"
	help
	  Select ddr dqs clock to 1066/2

config RTS3921_DDR_1200
	bool "DDR-1200"
	depends on RTS3921_QFN88_DDR2_512MBIT
	help
	  Select ddr dqs clock to 1200/2

config RTS3921_DDR_1333
	bool "DDR-1333"
	depends on !(RTS3921_QFN88_DDR2_512MBIT || RTS3921_BGA173_DDR2_512MBIT)
	help
	  Select ddr dqs clock to 1333/2

config RTS3921_DDR_1600
	bool "DDR-1600"
	depends on !(RTS3921_QFN88_DDR2_512MBIT || RTS3921_BGA173_DDR2_512MBIT)
	help
	  Select ddr dqs clock to 1600/2

config RTS3921_DDR_1866
	bool "DDR-1866"
	depends on !(RTS3921_QFN88_DDR2_512MBIT || RTS3921_BGA173_DDR2_512MBIT)
	help
	  Select ddr dqs clock to 1866/2

config RTS3921_DDR_2133
	bool "DDR-2133"
	depends on !(RTS3921_QFN88_DDR2_512MBIT || RTS3921_BGA173_DDR2_512MBIT)
	help
	  Select ddr dqs clock to 2133/2

endchoice
```

## chip/rts3917/sdk/rts39xx_sdk_v5.3/platform/source/kernel/linux-6.6/arch/arm/mach-realtek/Kconfig
```kconfig
# SPDX-License-Identifier: GPL-2.0-or-later
menuconfig ARCH_REALTEK
	bool "Realtek SoCs"
	select ARM_GIC
	select ARM_GIC_V3
	select HAVE_ARM_ARCH_TIMER
	select COMMON_CLK
	select GENERIC_IRQ_MULTI_HANDLER
	select CLKDEV_LOOKUP
	select GENERIC_CLOCKEVENTS
	select ARCH_HAS_CPUFREQ
	select HW_HAS_PCI
	select HW_HAS_USB
	select HAVE_ARM_SCU
	select HAVE_SMP
	select VFP
	select NEON
	select USE_OF
	select CPU_HAS_L2C

if ARCH_REALTEK

config RTS3917_SUSPEND_TO_RAM
	bool "RTS3917 suspend-to-RAM function"
	depends on SUSPEND
	help
	  Enable RTS3917 suspend-to-RAM function.

endif
```

## chip/rts3917/sdk/rts39xx_sdk_v5.3/platform/source/kernel/linux-6.6/arch/arm/mach-sheipa/Kconfig
```kconfig
# SPDX-License-Identifier: GPL-2.0-only
config SHEIPA
	bool

menuconfig ARCH_SHEIPA
	bool "Sheipa ARM platform"
	select SHEIPA
	select ARM_GIC
	select ARM_GIC_V3
	select HAVE_ARM_ARCH_TIMER
	select COMMON_CLK
	select GENERIC_IRQ_MULTI_HANDLER
	select CLKDEV_LOOKUP
	select GENERIC_CLOCKEVENTS
	select ARCH_HAS_CPUFREQ
	select HW_HAS_PCI
	select HW_HAS_USB
	select HAVE_ARM_SCU
	select HAVE_SMP
	select SMP
	select VFP
	select NEON
	select USE_OF
	select CPU_HAS_L2C
```

## chip/rts3917/sdk/rts39xx_sdk_v5.3/platform/source/kernel/linux-6.6/drivers/media/platform/rts_camera/Kconfig
```kconfig
menu "Realtek Video Driver"

config RTS_CAMERA
	tristate "RTS Camera Subsystem"
	select VIDEOBUF2_DMA_CONTIG
	help
	  Rts Soc Camera subsystem.

if RTS_CAMERA

config RTS_ISP_MEM
	tristate "Video DDR Manager"
	help
	  This is a memory driver for Realtek Soc Camera.

config RTS_CAM_LOCK
	tristate "Video Lock"
	help
	  This provides a first-in-first-out mutual exclusion mechanism.
	  Its implementation is based on completion.
	  H264 and Mjpeg enoder can use it.
	  You can get lock info by sysfs.

config RTS_VIDEO_ISP
	tristate "Video SoC Driver"
	select RTS_ISP_MEM
	help
	  This is a camera driver for Realtek RTS3917.

config RTS_W521MP_ENC
	tristate "Video H265&H264 Encoder Driver"
	select RTS_ISP_MEM
	help
	  This is a H265/H264 Encode device driver for Realtek RTS3917.

config RTS_MJPEG_ENC
	tristate "Video MJPEG Encoder Driver"
	select RTS_ISP_MEM
	select RTS_CAM_LOCK
	help
	  This is a Mjpeg Encoder device driver for Realtek RTS3917.

config RTS_OSD2
	tristate "Video OSD2 Module"
	select RTS_CAM_LOCK
	help
	  This is a Realtek OSD2 device driver.

config RTS_OSDI
	tristate "Video OSDI Module"
	help
	  This is a Realtek OSDI device driver.

config RTS_VIDEO_PP
	tristate "Video PP Module"
	help
	  This is a Realtek video report info driver.
	  mv and ssd and intra num and var

config RTS_BWT_MONITOR
	tristate "Video BWT Monitor"
	help
	  This is the driver for video bindwidth monitor for RTS3917.

config RTS_RTSTREAM_INFO
	tristate "Rtstream Info Driver"
	help
	  This driver help rtstream.

endif

endmenu
```

## chip/rts3917/sdk/rts39xx_sdk_v5.3/platform/source/kernel/linux-6.6/drivers/misc/rts_ipcam/Kconfig
```kconfig
#
# rts_ipcam misc driver configuration
#

menu "Realtek IPCam misc drivers"

config CAPE_REALTEK
        tristate "Realtek cape support"
        depends on OF_OVERLAY
        help
          Say Y here to include support for realtek capes

endmenu
```

## chip/rts3917/sdk/rts39xx_sdk_v5.3/platform/source/kernel/linux-6.6/drivers/pinctrl/realtek/Kconfig
```kconfig
config PINCTRL_RTS
	bool "Pinctrl driver for Realtek IPCam"
	depends on OF
	select PINMUX
	select PINCONF
	select GPIOLIB
	select GENERIC_PINCONF
	help
	  This is the pin controller and gpio driver for Realtek IPCam.
	  Say Y here to enable the pinctrl/gpio driver for IPCAM pin controller
	  available on IPCAM SoC.

	  Some pins are usually muxed to some other
	  functionality by driver,so only a small amount is available
	  for gpio use.
```

## chip/rts3917/sdk/rts39xx_sdk_v5.3/platform/source/kernel/linux-6.6/drivers/reset/realtek/Kconfig
```kconfig
config RESET_REALTEK
	tristate "Realtek Reset Driver"
	help
	  This enable the reset controller driver for Realtek IPCam.
```
