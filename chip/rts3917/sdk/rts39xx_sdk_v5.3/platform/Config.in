## chip/rts3917/sdk/rts39xx_sdk_v5.3/platform/Config.in
```kconfig
menu "Config build settings"

config BR2_OPTION_OVERRIDE
	bool "Switch On to override some buildroot options"
	default n
	depends on BR2_mips || BR2_mipsel
	help
	  Some RSDK components require specific override to buildroot
	  default options.

config BR2_GCC_TARGET_ARCH
	string "RSDK toolchain -march override"
	depends on BR2_OPTION_OVERRIDE
	help
	  The buildroot calculates -march=mips32 for Generic MIPS32 arch,
	  however this is not expected by RSDK toolchain, which expects
	  one specified in -march=3081|4081|4180|4181|4281|5181|5280|5281.
	  The value of this option overrides the default -march for gcc.

	  This must not be empty for RSDK toolchain.

config BR2_MAX_JLEVEL
	int "Max number of jobs to run simultaneously (0 for auto)"
	default "6"
	help
	  Maximum number of jobs to run simultaneously. If 0, determine
	  automatically according to number of CPUs on the host system.

config BR2_CONFIG_LSTRIP
	bool "Use lstrip to shrink/strip target binaries"
	default y
	help
	  Binaries and libraries in the target filesystem will be stripped
	  using 'lstrip' command in toolchain. This allows to save space,
	  mainly by removing unused shared libraries, shrinking libraries,
	  and stripping executables and libraries.

config BR2_CONFIG_LSTRIP_LIB_IN_STAGING
	bool "Shrink libraries in staging dir"
	default n
	depends on BR2_CONFIG_LSTRIP
	help
	  Add extra staging dir to shrink libraries.

endmenu

choice
  prompt "Selected target chip"

config BR2_CONFIG_HW_VER_RTS3917
  bool "rts3917"
  select BR2_PACKAGE_HOST_UBOOT_TOOLS
  select BR2_PACKAGE_HOST_UBOOT_TOOLS_FIT_SUPPORT
  select BR2_PACKAGE_HOST_UBOOT_TOOLS_FIT_SIGNATURE_SUPPORT

config BR2_CONFIG_HW_VER_RTS3921
  bool "rts3921"
  select BR2_PACKAGE_HOST_UBOOT_TOOLS
  select BR2_PACKAGE_HOST_UBOOT_TOOLS_FIT_SUPPORT
  select BR2_PACKAGE_HOST_UBOOT_TOOLS_FIT_SIGNATURE_SUPPORT
endchoice

config BR2_CONFIG_CRYPTO_BOOT
	bool "Support crypto boot"
	default n
	select BR2_PACKAGE_RTSKEY
	select BR2_TARGET_ROOTFS_INITRAMFS_MINI if BR2_CONFIG_DM_INIT != y
	help
	  Enable Crypto boot for Linux and Rootfs.

config BR2_CONFIG_CRYPTO_BOOT_USER_PARTITION
	bool "enable user partition"
	default y
	depends on BR2_CONFIG_CRYPTO_BOOT
	depends on BR2_FW_PACK_USERDATA_UBIFS || BR2_FW_PACK_USERDATA_EXT4

choice
	prompt "Select crypto boot mode"
	default BR2_CONFIG_FULL_DISK_ENCRYPTION
	depends on BR2_CONFIG_CRYPTO_BOOT

config BR2_CONFIG_FULL_DISK_ENCRYPTION
	bool "Full-disk encryption"
	depends on BR2_TARGET_ROOTFS_SQUASHFS || BR2_TARGET_ROOTFS_EXT2
	select BR2_PACKAGE_LVM2
	select BR2_PACKAGE_HOST_CRYPTSETUP
	select BR2_PACKAGE_HOST_PYTHON3_PYCRYPTODOMEX

config BR2_CONFIG_FILE_BASED_ENCRYPTION
	bool "File-based encryption"
	depends on BR2_TARGET_ROOTFS_UBIFS
	select BR2_PACKAGE_FSCRYPTCTL

endchoice

choice
	prompt "Select FBE cipher type"
	default BR2_CONFIG_FBE_AES_256_XTS
	depends on BR2_CONFIG_FILE_BASED_ENCRYPTION

config BR2_CONFIG_FBE_AES_128_CBC
	bool "FBE cipher AES_128_CBC"

config BR2_CONFIG_FBE_AES_256_XTS
	bool "FBE cipher AES_256_XTS"

endchoice

config BR2_CONFIG_SECURE_BOOT
	bool "Support secure boot"
	default n
	select BR2_TARGET_ARM_TRUSTED_FIRMWARE if y
	select BR2_PACKAGE_RTSKEY
	select BR2_TARGET_ROOTFS_INITRAMFS_MINI if BR2_CONFIG_DM_INIT != y
	help
	  Enable secure boot for U-Boot, Linux and Rootfs.

config BR2_CONFIG_SECURE_BOOT_USER_PARTITION
	bool "enable user partition"
	default n
	depends on BR2_CONFIG_SECURE_BOOT
	depends on BR2_FW_PACK_USERDATA_UBIFS || BR2_FW_PACK_USERDATA_EXT4
	select BR2_PACKAGE_CRYPTSETUP if BR2_FW_PACK_USERDATA_EXT4 = y
	help
	  Please note that enabling this option may cause performance and other
	  potential problems, so please read the SDK's security guide carefully
	  before enabling it. The security guide provides detailed information
	  and advice to help you decide whether to enable this option.

config BR2_CONFIG_SECURE_BOOT_PACK_DMINTEGRITY
	bool "pack dm-integrity format"
	default n
	depends on BR2_CONFIG_SECURE_BOOT_USER_PARTITION
	depends on BR2_FW_PACK_USERDATA_EXT4
	help
	  please confirm superuser privileges (need sudo) to pack dm-integrity format

choice
	prompt "Select secure boot mode"
	default BR2_CONFIG_SECURE_DM_MAPPER
	depends on BR2_CONFIG_SECURE_BOOT

config BR2_CONFIG_SECURE_DM_MAPPER
	bool "dm-verity or dm-integrity"
	depends on BR2_TARGET_ROOTFS_SQUASHFS || BR2_TARGET_ROOTFS_EXT2
	select BR2_PACKAGE_LVM2
	select BR2_PACKAGE_HOST_CRYPTSETUP
	select BR2_PACKAGE_HOST_PYTHON3_PYCRYPTODOMEX
	help
	  Use dm-verity on read-only filesystem.
	  Use dm-integrity on read-write filesystem.


config BR2_CONFIG_UBIFS_FS_AUTHENTICATION
	bool "ubifs fs authentication"
	depends on BR2_TARGET_ROOTFS_UBIFS
	select BR2_PACKAGE_KEYUTILS
endchoice

config BR2_CONFIG_DM_INIT
	bool "Support dm init"
	default n
	depends on BR2_CONFIG_SECURE_DM_MAPPER || BR2_CONFIG_FULL_DISK_ENCRYPTION
	help
	  Enable dm init.

config BR2_CONFIG_UBOOT_AS_BL33
	bool "Select uboot as bl33"
	default n
	depends on BR2_CONFIG_SECURE_BOOT
	select BR2_TARGET_ARM_TRUSTED_FIRMWARE_UBOOT_AS_BL33 if y
	help
	  U-boot is as bl33 or bl2, default is bl2.


source "$BR2_EXTERNAL_platform_PATH/package/Config.in"
source "$BR2_EXTERNAL_platform_PATH/package/Config.in.host"

comment "Firmware pack"
config BR2_FW_PACK_MERGE_FILE
	string "Merge setting file"
	default "$(BR2_EXTERNAL)/board/common/pack_merge.ini"
	help
	  Firmware merge setting file for make pack

choice
	prompt "Select the filesystem of user data"
	default BR2_FW_PACK_USERDATA_UBIFS if BR2_TARGET_ROOTFS_UBIFS
	default BR2_FW_PACK_USERDATA_JFFS2 if BR2_TARGET_ROOTFS_SQUASHFS
	default BR2_FW_PACK_USERDATA_EXT4 if BR2_TARGET_ROOTFS_EXT2

config BR2_FW_PACK_USERDATA_JFFS2
	bool "jffs2"
config BR2_FW_PACK_USERDATA_UBIFS
	bool "ubifs"
config BR2_FW_PACK_USERDATA_EXT4
	bool "ext4"
config BR2_FW_PACK_USERDATA_SQUASHFS
	bool "squashfs"
endchoice

config BR2_CONFIG_BUNDLE_OTA
	bool "Support ota update file"
	select BR2_PACKAGE_OTA_UPFW
	default n
	help
	  ota,support rauc and swupdate

if BR2_CONFIG_BUNDLE_OTA
choice
	prompt "Selected pack method to use"
	default BR2_CONFIG_BUNDLE_RAUCB

	config BR2_CONFIG_BUNDLE_RAUCB
		bool "Support raucb file"
		select BR2_PACKAGE_RAUC_UPFW
		select BR2_PACKAGE_HOST_RAUC
		help
		  Enable rauc for bundle raucb file.

	config BR2_CONFIG_BUNDLE_SWU
		bool "Support swu file"
		select BR2_PACKAGE_SWU_UPFW
		select BR2_PACKAGE_HOST_CPIO
		help
		  Enable rauc for bundle swu file.
endchoice

endif
```

## chip/rts3917/sdk/rts39xx_sdk_v5.3/platform/board/rts3917/linux_5.4_defconfig
```kconfig
# CONFIG_LOCALVERSION_AUTO is not set
CONFIG_KERNEL_LZMA=y
CONFIG_DEFAULT_HOSTNAME="rts"
CONFIG_SYSVIPC=y
CONFIG_POSIX_MQUEUE=y
# CONFIG_CROSS_MEMORY_ATTACH is not set
CONFIG_PREEMPT=y
CONFIG_LOG_BUF_SHIFT=12
CONFIG_CC_OPTIMIZE_FOR_SIZE=y
CONFIG_BASE_FULL=y
CONFIG_SHMEM=y
# CONFIG_KALLSYMS is not set
CONFIG_EMBEDDED=y
# CONFIG_VM_EVENT_COUNTERS is not set
CONFIG_ARM_PSCI=y
CONFIG_HZ_250=y
# CONFIG_ATAGS is not set
CONFIG_ARM_APPENDED_DTB=y
CONFIG_KERNEL_MODE_NEON=y
# CONFIG_SUSPEND is not set
CONFIG_PM=y
CONFIG_ARM_CRYPTO=y
CONFIG_CRYPTO_SHA1_ARM_NEON=y
CONFIG_CRYPTO_SHA256_ARM=y
CONFIG_CRYPTO_SHA512_ARM=y
CONFIG_CRYPTO_AES_ARM=y
CONFIG_CRYPTO_AES_ARM_BS=y
CONFIG_CRYPTO_GHASH_ARM_CE=y
CONFIG_CRYPTO_CHACHA20_NEON=y
CONFIG_CRYPTO_NHPOLY1305_NEON=y
CONFIG_MODULES=y
CONFIG_MODULE_UNLOAD=y
CONFIG_MODVERSIONS=y
# CONFIG_COREDUMP is not set
CONFIG_CMA=y
CONFIG_NET=y
CONFIG_PACKET=y
CONFIG_UNIX=y
CONFIG_INET=y
CONFIG_SYN_COOKIES=y
# CONFIG_INET_DIAG is not set
# CONFIG_IPV6 is not set
CONFIG_NETFILTER=y
# CONFIG_BRIDGE_NETFILTER is not set
CONFIG_NF_CONNTRACK=y
# CONFIG_NF_CT_PROTO_DCCP is not set
# CONFIG_NF_CT_PROTO_SCTP is not set
# CONFIG_NF_CT_PROTO_UDPLITE is not set
CONFIG_NETFILTER_XT_MATCH_IPRANGE=y
CONFIG_IP_NF_IPTABLES=y
CONFIG_IP_NF_FILTER=y
CONFIG_IP_NF_NAT=y
CONFIG_IP_NF_TARGET_MASQUERADE=y
CONFIG_BRIDGE=y
# CONFIG_BRIDGE_IGMP_SNOOPING is not set
CONFIG_CFG80211=y
# CONFIG_CFG80211_DEFAULT_PS is not set
CONFIG_MAC80211=y
# CONFIG_MAC80211_RC_MINSTREL is not set
CONFIG_MAC80211_MESH=y
CONFIG_UEVENT_HELPER=y
CONFIG_DEVTMPFS=y
CONFIG_DEVTMPFS_MOUNT=y
CONFIG_EXTRA_FIRMWARE="regulatory.db regulatory.db.p7s"
CONFIG_EXTRA_FIRMWARE_DIR="${TARGET_DIR}/lib/firmware"
CONFIG_MTD=y
CONFIG_MTD_BLOCK=y
CONFIG_MTD_SPI_NOR=y
# CONFIG_MTD_SPI_NOR_USE_4K_SECTORS is not set
CONFIG_SPI_RTS_QUADSPI=y
# CONFIG_RTS_DDRC is not set
CONFIG_NETDEVICES=y
# CONFIG_NET_VENDOR_ALACRITECH is not set
# CONFIG_NET_VENDOR_AMAZON is not set
# CONFIG_NET_VENDOR_AQUANTIA is not set
# CONFIG_NET_VENDOR_ARC is not set
# CONFIG_NET_VENDOR_AURORA is not set
# CONFIG_NET_VENDOR_BROADCOM is not set
# CONFIG_NET_VENDOR_CADENCE is not set
# CONFIG_NET_VENDOR_CAVIUM is not set
# CONFIG_NET_VENDOR_CIRRUS is not set
# CONFIG_NET_VENDOR_CORTINA is not set
# CONFIG_NET_VENDOR_EZCHIP is not set
# CONFIG_NET_VENDOR_FARADAY is not set
# CONFIG_NET_VENDOR_GOOGLE is not set
# CONFIG_NET_VENDOR_HISILICON is not set
# CONFIG_NET_VENDOR_HUAWEI is not set
# CONFIG_NET_VENDOR_INTEL is not set
# CONFIG_NET_VENDOR_MARVELL is not set
# CONFIG_NET_VENDOR_MELLANOX is not set
# CONFIG_NET_VENDOR_MICREL is not set
# CONFIG_NET_VENDOR_MICROCHIP is not set
# CONFIG_NET_VENDOR_MICROSEMI is not set
# CONFIG_NET_VENDOR_NATSEMI is not set
# CONFIG_NET_VENDOR_NETRONOME is not set
# CONFIG_NET_VENDOR_NI is not set
# CONFIG_NET_VENDOR_PENSANDO is not set
# CONFIG_NET_VENDOR_QUALCOMM is not set
CONFIG_RTL8168G_8048=y
# CONFIG_NET_VENDOR_RENESAS is not set
# CONFIG_NET_VENDOR_ROCKER is not set
# CONFIG_NET_VENDOR_SAMSUNG is not set
# CONFIG_NET_VENDOR_SEEQ is not set
# CONFIG_NET_VENDOR_SOLARFLARE is not set
# CONFIG_NET_VENDOR_SMSC is not set
# CONFIG_NET_VENDOR_SOCIONEXT is not set
# CONFIG_NET_VENDOR_STMICRO is not set
# CONFIG_NET_VENDOR_SYNOPSYS is not set
# CONFIG_NET_VENDOR_VIA is not set
# CONFIG_NET_VENDOR_WIZNET is not set
# CONFIG_NET_VENDOR_XILINX is not set
# CONFIG_WLAN is not set
# CONFIG_INPUT is not set
# CONFIG_SERIO is not set
# CONFIG_VT is not set
# CONFIG_LEGACY_PTYS is not set
CONFIG_SERIAL_8250=y
# CONFIG_SERIAL_8250_DEPRECATED_OPTIONS is not set
CONFIG_SERIAL_8250_CONSOLE=y
CONFIG_SERIAL_8250_NR_UARTS=3
CONFIG_SERIAL_8250_RUNTIME_UARTS=3
CONFIG_SERIAL_8250_DW=y
CONFIG_HW_RANDOM=y
CONFIG_I2C=y
CONFIG_I2C_CHARDEV=y
CONFIG_I2C_DESIGNWARE_PLATFORM=y
CONFIG_SPI=y
CONFIG_PINCTRL=y
CONFIG_PINCTRL_RTS=y
CONFIG_GPIO_SYSFS=y
# CONFIG_HWMON is not set
CONFIG_THERMAL=y
CONFIG_RTS_THERMAL=y
CONFIG_WATCHDOG=y
CONFIG_RTSX_WATCHDOG=y
CONFIG_MEDIA_SUPPORT=y
CONFIG_MEDIA_CAMERA_SUPPORT=y
CONFIG_V4L_PLATFORM_DRIVERS=y
CONFIG_RTS_CAMERA=m
CONFIG_RTS_VIDEO_ISP=m
CONFIG_RTS_W521MP_ENC=m
CONFIG_RTS_MJPEG_ENC=m
CONFIG_RTS_OSD2=m
CONFIG_RTS_OSDI=m
CONFIG_RTS_RTSTREAM_INFO=m
CONFIG_SOUND=y
CONFIG_SND=y
CONFIG_SND_SOC=y
CONFIG_SND_SOC_RTS_INTERN_CODEC=m
CONFIG_USB_ARCH_HAS_EHCI=y
CONFIG_USB=y
CONFIG_USB_EHCI_HCD=y
CONFIG_USB_EHCI_RTS=y
CONFIG_USB_RTS_PHY=y
CONFIG_MMC=y
CONFIG_MMC_REALTEK_IPCAM=m
# CONFIG_MMC_REALTEK_IPCAM_DEBUG is not set
CONFIG_NEW_LEDS=y
CONFIG_LEDS_CLASS=y
CONFIG_LEDS_GPIO=y
CONFIG_LEDS_TRIGGERS=y
CONFIG_LEDS_TRIGGER_TIMER=y
CONFIG_LEDS_TRIGGER_ONESHOT=y
CONFIG_LEDS_TRIGGER_HEARTBEAT=y
CONFIG_RTC_CLASS=y
CONFIG_RTC_DRV_RTS=y
# CONFIG_ARM_ARCH_TIMER_EVTSTREAM is not set
# CONFIG_IOMMU_SUPPORT is not set
CONFIG_RESET_CONTROLLER=y
CONFIG_RESET_REALTEK=y
CONFIG_RTS_OTP=y
# CONFIG_MANDATORY_FILE_LOCKING is not set
# CONFIG_DNOTIFY is not set
CONFIG_OVERLAY_FS=y
CONFIG_VFAT_FS=y
CONFIG_TMPFS=y
CONFIG_TMPFS_POSIX_ACL=y
CONFIG_JFFS2_FS=y
# CONFIG_JFFS2_FS_WRITEBUFFER is not set
CONFIG_JFFS2_FS_XATTR=y
# CONFIG_JFFS2_FS_POSIX_ACL is not set
# CONFIG_JFFS2_FS_SECURITY is not set
CONFIG_SQUASHFS=y
# CONFIG_SQUASHFS_ZLIB is not set
CONFIG_SQUASHFS_XZ=y
CONFIG_NFS_FS=y
CONFIG_NFS_V4=y
CONFIG_NLS_CODEPAGE_437=y
CONFIG_NLS_ISO8859_1=y
CONFIG_CRYPTO_USER=y
CONFIG_CRYPTO_USER_API_HASH=y
CONFIG_CRYPTO_USER_API_SKCIPHER=y
CONFIG_CRYPTO_USER_API_AEAD=y
CONFIG_CRYPTO_USER_API_AKCIPHER=y
CONFIG_CRYPTO_DEV_REALTEK=y
CONFIG_CRYPTO_DEV_REALTEK_SHA=y
CONFIG_CRYPTO_DEV_REALTEK_RSA=y
CONFIG_DMA_CMA=y
CONFIG_CMA_SIZE_MBYTES=0
CONFIG_PRINTK_TIME=y
CONFIG_DEBUG_FS=y
# CONFIG_SCHED_DEBUG is not set
# CONFIG_DEBUG_BUGVERBOSE is not set
# CONFIG_FTRACE is not set
CONFIG_STRICT_DEVMEM=y
CONFIG_DEBUG_USER=y
CONFIG_DEBUG_LL=y
CONFIG_DEBUG_UART_PHYS=0x18810100
CONFIG_DEBUG_UART_VIRT=0xfee10100
CONFIG_EARLY_PRINTK=y
```
