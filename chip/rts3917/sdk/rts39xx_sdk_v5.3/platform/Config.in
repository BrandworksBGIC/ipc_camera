## chip/rts3917/sdk/rts39xx_sdk_v5.3/platform/configs/rts3918n_base_defconfig
```kconfig
BR2_arm=y
BR2_cortex_a7=y
BR2_ARM_FPU_NEON_VFPV4=y
BR2_TOOLCHAIN_EXTERNAL=y
BR2_TOOLCHAIN_EXTERNAL_CUSTOM=y
BR2_TOOLCHAIN_EXTERNAL_PATH="$(TOPDIR)/../toolchain/asdk-12.4.1-a7-EL-6.6-u1.0-a32nh-linux-x86_64-250925"
BR2_TOOLCHAIN_EXTERNAL_CUSTOM_PREFIX="asdk-linux"
BR2_TOOLCHAIN_EXTERNAL_GCC_12=y
BR2_TOOLCHAIN_EXTERNAL_HEADERS_6_6=y
BR2_TOOLCHAIN_EXTERNAL_WCHAR=y
BR2_TOOLCHAIN_EXTERNAL_HAS_SSP=y
BR2_TOOLCHAIN_EXTERNAL_CXX=y
BR2_TOOLCHAIN_EXTERNAL_OPENMP=y
BR2_TOOLCHAIN_EXTRA_LIBS="libgomp.so* libssp.so* libthread_db*.so*"
BR2_TARGET_OPTIMIZATION="-fstrict-aliasing -fstrict-overflow -D_FORTIFY_SOURCE=2"
BR2_DL_DIR="$(TOPDIR)/../dl"
BR2_JLEVEL=12
BR2_OPTIMIZE_S=y
BR2_PACKAGE_OVERRIDE_FILE="$(BR2_EXTERNAL)/local.mk"
BR2_GLOBAL_PATCH_DIR="$(BR2_EXTERNAL)/patches"
BR2_SSP_ALL=y
BR2_TARGET_GENERIC_HOSTNAME=""
BR2_TARGET_GENERIC_ISSUE=""
BR2_ROOTFS_DEVICE_CREATION_DYNAMIC_MDEV=y
BR2_ROOTFS_MERGED_USR=y
BR2_SYSTEM_ENABLE_NLS=y
BR2_ROOTFS_OVERLAY="$(BR2_EXTERNAL)/board/rts3917/rootfs_overlay"
BR2_ROOTFS_POST_BUILD_SCRIPT="$(BR2_EXTERNAL)/board/rts3917/post_build.sh"
BR2_ROOTFS_POST_IMAGE_SCRIPT="$(BR2_EXTERNAL)/board/rts3917/post_image.sh"
BR2_LINUX_KERNEL_CUSTOM_VERSION=y
BR2_LINUX_KERNEL_CUSTOM_VERSION_VALUE="6.6"
BR2_LINUX_KERNEL_USE_CUSTOM_CONFIG=y
BR2_LINUX_KERNEL_CUSTOM_CONFIG_FILE="$(BR2_EXTERNAL)/board/rts3917/linux_$(BR2_LINUX_KERNEL_CUSTOM_VERSION_VALUE)_defconfig"
BR2_LINUX_KERNEL_APPENDED_UIMAGE=y
BR2_LINUX_KERNEL_XZ=y
BR2_LINUX_KERNEL_UIMAGE_LOADADDR="0x81000000"
BR2_LINUX_KERNEL_INTREE_DTS_NAME="realtek/rts3918n_evb_ipc_16m"
BR2_PACKAGE_BUSYBOX_CONFIG="$(BR2_EXTERNAL)/board/rts3917/busybox.config"
BR2_PACKAGE_ALSA_UTILS=y
# BR2_PACKAGE_ALSA_UTILS_ALSACTL is not set
# BR2_PACKAGE_ALSA_UTILS_ALSAMIXER is not set
# BR2_PACKAGE_MTD_FLASHCP is not set
# BR2_PACKAGE_MTD_FLASH_ERASE is not set
# BR2_PACKAGE_MTD_FLASH_LOCK is not set
# BR2_PACKAGE_MTD_FLASH_UNLOCK is not set
# BR2_PACKAGE_MTD_MTD_DEBUG is not set
# BR2_PACKAGE_MTD_NANDDUMP is not set
# BR2_PACKAGE_MTD_NANDTEST is not set
# BR2_PACKAGE_MTD_NANDWRITE is not set
# BR2_PACKAGE_MTD_MTDINFO is not set
# BR2_PACKAGE_MTD_UBIATTACH is not set
# BR2_PACKAGE_MTD_UBICRC32 is not set
# BR2_PACKAGE_MTD_UBIDETACH is not set
# BR2_PACKAGE_MTD_UBIFORMAT is not set
# BR2_PACKAGE_MTD_UBIHEALTHD is not set
# BR2_PACKAGE_MTD_UBIMKVOL is not set
# BR2_PACKAGE_MTD_UBINFO is not set
# BR2_PACKAGE_MTD_UBINIZE is not set
# BR2_PACKAGE_MTD_UBIRENAME is not set
# BR2_PACKAGE_MTD_UBIRMVOL is not set
# BR2_PACKAGE_MTD_UBIRSVOL is not set
# BR2_PACKAGE_MTD_UBIUPDATEVOL is not set
# BR2_PACKAGE_MTD_UBIBLOCK is not set
# BR2_PACKAGE_LVM2_STANDARD_INSTALL is not set
BR2_PACKAGE_ALSA_LIB_PCM_PLUGINS=""
BR2_PACKAGE_ALSA_LIB_CTL_PLUGINS=""
# BR2_PACKAGE_ALSA_LIB_ALOAD is not set
# BR2_PACKAGE_ALSA_LIB_MIXER is not set
# BR2_PACKAGE_ALSA_LIB_RAWMIDI is not set
# BR2_PACKAGE_ALSA_LIB_HWDEP is not set
# BR2_PACKAGE_ALSA_LIB_SEQ is not set
# BR2_PACKAGE_ALSA_LIB_UCM is not set
# BR2_PACKAGE_ALSA_LIB_ALISP is not set
# BR2_PACKAGE_ALSA_LIB_OLD_SYMBOLS is not set
# BR2_PACKAGE_ALSA_LIB_TOPOLOGY is not set
BR2_PACKAGE_ZLIB=y
# BR2_PACKAGE_IFUPDOWN_SCRIPTS is not set
BR2_TARGET_ROOTFS_CPIO_XZ=y
BR2_TARGET_ROOTFS_SQUASHFS=y
BR2_TARGET_ROOTFS_SQUASHFS4_XZ=y
# BR2_TARGET_ROOTFS_TAR is not set
BR2_TARGET_ARM_TRUSTED_FIRMWARE_CUSTOM_VERSION=y
BR2_TARGET_ARM_TRUSTED_FIRMWARE_CUSTOM_VERSION_VALUE="2.3"
BR2_TARGET_ARM_TRUSTED_FIRMWARE_PLATFORM="sheipa"
BR2_TARGET_ARM_TRUSTED_FIRMWARE_FIP=y
BR2_TARGET_UBOOT=y
BR2_TARGET_UBOOT_BUILD_SYSTEM_KCONFIG=y
BR2_TARGET_UBOOT_CUSTOM_VERSION=y
BR2_TARGET_UBOOT_CUSTOM_VERSION_VALUE="2023.01"
BR2_TARGET_UBOOT_USE_CUSTOM_CONFIG=y
BR2_TARGET_UBOOT_CUSTOM_CONFIG_FILE="$(BR2_EXTERNAL)/board/rts3917/uboot_$(BR2_TARGET_UBOOT_CUSTOM_VERSION_VALUE)_3918n_defconfig"
BR2_TARGET_UBOOT_CUSTOM_MAKEOPTS="EXT_DTB=u-boot.dtb"
BR2_PACKAGE_HOST_MTD=y
BR2_CONFIG_SECURE_BOOT=y
# BR2_CONFIG_RTW_COMPILER_OPTIMIZATION is not set
BR2_PACKAGE_CMOS_SENSOR_LIST="sc2310,sc3235,sc401ai_2lane,sc4238,sc5335p,sc8238,imx307,jxf22,sc3338_mipi,fixp,default"
BR2_PACKAGE_LIBRTSIO=y
# BR2_PACKAGE_LIBRTSCRYPT is not set
BR2_PACKAGE_RAINBOW=y
BR2_PACKAGE_HOST_PYTHON3_PYDEVICETREE=y
BR2_FW_PACK_USERDATA_SQUASHFS=y
```

## chip/rts3917/sdk/rts39xx_sdk_v5.3/platform/package/Config.in
```kconfig
source "$BR2_EXTERNAL_platform_PATH/package/driver/Config.in"
source "$BR2_EXTERNAL_platform_PATH/package/rtscore/Config.in"
source "$BR2_EXTERNAL_platform_PATH/package/lib/Config.in"
source "$BR2_EXTERNAL_platform_PATH/package/system/Config.in"
source "$BR2_EXTERNAL_platform_PATH/package/usb/Config.in"
source "$BR2_EXTERNAL_platform_PATH/package/buildroot/Config.in"
```

## chip/rts3917/sdk/rts39xx_sdk_v5.3/platform/package/Config.in.host
```kconfig
comment "Host utilities"

menu "Host utilities"

source "$BR2_EXTERNAL_platform_PATH/package/buildroot/Config.in.host"

endmenu
```
