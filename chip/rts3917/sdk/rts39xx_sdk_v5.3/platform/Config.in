## chip/rts3917/sdk/rts39xx_sdk_v5.3/platform/board/rts3917/linux_6.6_defconfig
```kconfig
# CONFIG_LOCALVERSION_AUTO is not set
CONFIG_KERNEL_XZ=y
CONFIG_DEFAULT_HOSTNAME="formosa"
CONFIG_SYSVIPC=y
CONFIG_POSIX_MQUEUE=y
# CONFIG_CROSS_MEMORY_ATTACH is not set
CONFIG_NO_HZ_IDLE=y
CONFIG_HIGH_RES_TIMERS=y
CONFIG_PREEMPT=y
CONFIG_LOG_BUF_SHIFT=12
CONFIG_BLK_DEV_INITRD=y
CONFIG_INITRAMFS_SOURCE="${BR_BINARIES_DIR}/rootfs.cpio"
# CONFIG_RD_GZIP is not set
# CONFIG_RD_BZIP2 is not set
# CONFIG_RD_LZMA is not set
# CONFIG_RD_LZO is not set
# CONFIG_RD_LZ4 is not set
CONFIG_CC_OPTIMIZE_FOR_SIZE=y
CONFIG_EXPERT=y
# CONFIG_KALLSYMS is not set
# CONFIG_ARCH_MULTIPLATFORM is not set
CONFIG_ARCH_REALTEK=y
CONFIG_ARM_PSCI=y
CONFIG_HZ_250=y
# CONFIG_ATAGS is not set
CONFIG_ARM_APPENDED_DTB=y
CONFIG_KERNEL_MODE_NEON=y
# CONFIG_SUSPEND is not set
CONFIG_PM=y
# CONFIG_VMAP_STACK is not set
# CONFIG_GCC_PLUGINS is not set
CONFIG_MODULES=y
CONFIG_MODULE_UNLOAD=y
CONFIG_MODVERSIONS=y
CONFIG_IOSCHED_BFQ=y
# CONFIG_COREDUMP is not set
CONFIG_ZSWAP=y
CONFIG_ZSWAP_COMPRESSOR_DEFAULT_ZSTD=y
CONFIG_ZSWAP_ZPOOL_DEFAULT_ZSMALLOC=y
CONFIG_SLAB_FREELIST_RANDOM=y
CONFIG_SHUFFLE_PAGE_ALLOCATOR=y
# CONFIG_COMPACTION is not set
CONFIG_CMA=y
# CONFIG_VM_EVENT_COUNTERS is not set
CONFIG_NET=y
CONFIG_PACKET=y
CONFIG_UNIX=y
CONFIG_INET=y
# CONFIG_INET_DIAG is not set
CONFIG_IPV6_ROUTER_PREF=y
CONFIG_IPV6_ROUTE_INFO=y
# CONFIG_IPV6_SIT is not set
CONFIG_DNS_RESOLVER=y
CONFIG_BT=m
# CONFIG_BT_BREDR is not set
# CONFIG_BT_LE is not set
# CONFIG_BT_DEBUGFS is not set
CONFIG_CFG80211=y
# CONFIG_CFG80211_DEFAULT_PS is not set
# CONFIG_CFG80211_CRDA_SUPPORT is not set
CONFIG_CFG80211_WEXT=y
CONFIG_MAC80211=m
# CONFIG_MAC80211_RC_MINSTREL is not set
CONFIG_UEVENT_HELPER=y
CONFIG_DEVTMPFS=y
CONFIG_DEVTMPFS_MOUNT=y
CONFIG_MTD=y
CONFIG_MTD_BLOCK=y
CONFIG_MTD_SPI_NOR=y
# CONFIG_MTD_SPI_NOR_USE_4K_SECTORS is not set
CONFIG_SPI_RTS_QUADSPI=y
CONFIG_ZRAM=y
CONFIG_ZRAM_WRITEBACK=y
CONFIG_BLK_DEV_LOOP=y
CONFIG_MD=y
CONFIG_BLK_DEV_DM=y
CONFIG_DM_VERITY=y
CONFIG_NETDEVICES=y
# CONFIG_NET_VENDOR_ALACRITECH is not set
# CONFIG_NET_VENDOR_AMAZON is not set
# CONFIG_NET_VENDOR_AQUANTIA is not set
# CONFIG_NET_VENDOR_ARC is not set
# CONFIG_NET_VENDOR_BROADCOM is not set
# CONFIG_NET_VENDOR_CADENCE is not set
# CONFIG_NET_VENDOR_CAVIUM is not set
# CONFIG_NET_VENDOR_CIRRUS is not set
# CONFIG_NET_VENDOR_CORTINA is not set
# CONFIG_NET_VENDOR_EZCHIP is not set
# CONFIG_NET_VENDOR_FARADAY is not set
# CONFIG_NET_VENDOR_GOOGLE is not set
# CONFIG_NET_VENDOR_HISILICON is not set
# CONFIG_NET_VENDOR_HUAWEI is not set
# CONFIG_NET_VENDOR_INTEL is not set
# CONFIG_NET_VENDOR_MARVELL is not set
# CONFIG_NET_VENDOR_MELLANOX is not set
# CONFIG_NET_VENDOR_MICREL is not set
# CONFIG_NET_VENDOR_MICROCHIP is not set
# CONFIG_NET_VENDOR_MICROSEMI is not set
# CONFIG_NET_VENDOR_NI is not set
# CONFIG_NET_VENDOR_NATSEMI is not set
# CONFIG_NET_VENDOR_NETRONOME is not set
# CONFIG_NET_VENDOR_PENSANDO is not set
# CONFIG_NET_VENDOR_QUALCOMM is not set
CONFIG_RTL8168G_8048=y
CONFIG_NUM_TX_DESC_256=y
# CONFIG_NET_VENDOR_RENESAS is not set
# CONFIG_NET_VENDOR_ROCKER is not set
# CONFIG_NET_VENDOR_SAMSUNG is not set
# CONFIG_NET_VENDOR_SEEQ is not set
# CONFIG_NET_VENDOR_SOLARFLARE is not set
# CONFIG_NET_VENDOR_SMSC is not set
# CONFIG_NET_VENDOR_SOCIONEXT is not set
# CONFIG_NET_VENDOR_STMICRO is not set
# CONFIG_NET_VENDOR_SYNOPSYS is not set
# CONFIG_NET_VENDOR_VIA is not set
# CONFIG_NET_VENDOR_WIZNET is not set
# CONFIG_NET_VENDOR_XILINX is not set
CONFIG_USB_USBNET=y
# CONFIG_USB_NET_AX8817X is not set
# CONFIG_USB_NET_AX88179_178A is not set
# CONFIG_USB_NET_NET1080 is not set
# CONFIG_USB_BELKIN is not set
# CONFIG_USB_ARMLINUX is not set
# CONFIG_USB_NET_ZAURUS is not set
# CONFIG_WLAN is not set
CONFIG_WWAN=y
# CONFIG_INPUT is not set
# CONFIG_SERIO is not set
# CONFIG_VT is not set
# CONFIG_LEGACY_PTYS is not set
CONFIG_SERIAL_8250=y
# CONFIG_SERIAL_8250_DEPRECATED_OPTIONS is not set
CONFIG_SERIAL_8250_CONSOLE=y
CONFIG_SERIAL_8250_NR_UARTS=3
CONFIG_SERIAL_8250_RUNTIME_UARTS=3
CONFIG_SERIAL_8250_DW=y
CONFIG_HW_RANDOM=y
CONFIG_I2C=y
CONFIG_I2C_CHARDEV=y
CONFIG_I2C_DESIGNWARE_PLATFORM=y
CONFIG_SPI=y
CONFIG_PINCTRL=y
CONFIG_PINCTRL_RTS=y
CONFIG_GPIO_SYSFS=y
CONFIG_SENSORS_RTS_SARADC=y
CONFIG_THERMAL=y
CONFIG_RTS_THERMAL=y
CONFIG_WATCHDOG=y
CONFIG_RTSX_WATCHDOG=y
CONFIG_MEDIA_SUPPORT=y
CONFIG_MEDIA_SUPPORT_FILTER=y
# CONFIG_MEDIA_SUBDRV_AUTOSELECT is not set
CONFIG_MEDIA_CAMERA_SUPPORT=y
CONFIG_MEDIA_PLATFORM_SUPPORT=y
CONFIG_V4L_PLATFORM_DRIVERS=y
CONFIG_RTS_CAMERA=m
CONFIG_RTS_VIDEO_ISP=m
CONFIG_RTS_W521MP_ENC=m
CONFIG_RTS_MJPEG_ENC=m
CONFIG_RTS_OSD2=m
CONFIG_RTS_OSDI=m
CONFIG_RTS_RTSTREAM_INFO=m
# CONFIG_VIDEO_CAMERA_SENSOR is not set
CONFIG_SOUND=y
CONFIG_SND=y
CONFIG_SND_SOC=y
CONFIG_SND_SOC_RTS_INTERN_CODEC=m
CONFIG_USB=y
CONFIG_USB_EHCI_HCD=y
CONFIG_USB_EHCI_RTS=y
CONFIG_USB_ACM=y
CONFIG_USB_SERIAL=y
CONFIG_USB_SERIAL_GENERIC=y
CONFIG_USB_SERIAL_OPTION=y
CONFIG_USB_RTS_PHY=y
CONFIG_MMC=m
CONFIG_MMC_REALTEK_IPCAM=m
# CONFIG_MMC_REALTEK_IPCAM_DEBUG is not set
CONFIG_RTC_CLASS=y
CONFIG_RTC_DRV_RTS=y
# CONFIG_VHOST_MENU is not set
# CONFIG_ARM_ARCH_TIMER_EVTSTREAM is not set
# CONFIG_IOMMU_SUPPORT is not set
CONFIG_RESET_CONTROLLER=y
CONFIG_RESET_REALTEK=y
CONFIG_RTS_OTP=y
# CONFIG_DNOTIFY is not set
CONFIG_FSCACHE=y
CONFIG_VFAT_FS=y
CONFIG_EXFAT_FS=y
CONFIG_TMPFS=y
CONFIG_TMPFS_POSIX_ACL=y
CONFIG_CONFIGFS_FS=y
CONFIG_JFFS2_FS=y
# CONFIG_JFFS2_FS_WRITEBUFFER is not set
CONFIG_JFFS2_FS_XATTR=y
# CONFIG_JFFS2_FS_POSIX_ACL is not set
# CONFIG_JFFS2_FS_SECURITY is not set
CONFIG_SQUASHFS=y
# CONFIG_SQUASHFS_ZLIB is not set
CONFIG_SQUASHFS_XZ=y
CONFIG_SQUASHFS_ZSTD=y
CONFIG_SQUASHFS_EMBEDDED=y
# CONFIG_NETWORK_FILESYSTEMS is not set
CONFIG_NLS_CODEPAGE_437=y
CONFIG_NLS_ISO8859_1=y
CONFIG_CRYPTO_USER=y
CONFIG_CRYPTO_ECB=y
CONFIG_CRYPTO_USER_API_HASH=y
CONFIG_CRYPTO_USER_API_SKCIPHER=y
CONFIG_CRYPTO_USER_API_AEAD=y
CONFIG_CRYPTO_USER_API_AKCIPHER=y
CONFIG_CRYPTO_GHASH_ARM_CE=y
CONFIG_CRYPTO_NHPOLY1305_NEON=y
CONFIG_CRYPTO_SHA1_ARM_NEON=y
CONFIG_CRYPTO_SHA256_ARM=y
CONFIG_CRYPTO_SHA512_ARM=y
CONFIG_CRYPTO_AES_ARM=y
CONFIG_CRYPTO_AES_ARM_BS=y
CONFIG_CRYPTO_CHACHA20_NEON=y
CONFIG_CRYPTO_DEV_REALTEK=y
CONFIG_CRYPTO_DEV_REALTEK_SHA=y
CONFIG_CRYPTO_DEV_REALTEK_RSA=y
CONFIG_DMA_CMA=y
CONFIG_CMA_SIZE_MBYTES=0
CONFIG_PRINTK_TIME=y
# CONFIG_DEBUG_BUGVERBOSE is not set
# CONFIG_DEBUG_MISC is not set
# CONFIG_SLUB_DEBUG is not set
# CONFIG_FTRACE is not set
CONFIG_STRICT_DEVMEM=y
CONFIG_DEBUG_USER=y
CONFIG_DEBUG_LL=y
CONFIG_DEBUG_LL_UART_8250=y
CONFIG_DEBUG_UART_PHYS=0x18810100
CONFIG_DEBUG_UART_VIRT=0xfee10100
CONFIG_DEBUG_UNCOMPRESS=y
CONFIG_EARLY_PRINTK=y
# CONFIG_RUNTIME_TESTING_MENU is not set
```

## chip/rts3917/sdk/rts39xx_sdk_v5.3/platform/board/rts3917/uboot_2020.04_3917n_defconfig
```kconfig
CONFIG_BOARD_RTS3917=y
CONFIG_TARGET_ASIC=y
CONFIG_RTS3917_QFN88_DDR2_512MBIT=y
CONFIG_RTS3917_DDR_1200=y
CONFIG_ENV_IN_FLASH=y
CONFIG_CPU_800M=y
CONFIG_KERNEL_ADDR=0xc0000
CONFIG_FDT_ADDR=0x80100000
CONFIG_FDT_FLASH_ADDR=0xa0000
```

## chip/rts3917/sdk/rts39xx_sdk_v5.3/platform/board/rts3917/uboot_2020.04_3917n_nand_defconfig
```kconfig
CONFIG_BOARD_RTS3917=y
CONFIG_TARGET_ASIC=y
CONFIG_RTS3917_QFN88_DDR2_512MBIT=y
CONFIG_RTS3917_DDR_1200=y
CONFIG_DUAL_KERNEL_LOAD_CHECK=y
CONFIG_ENV_IN_FLASH=y
CONFIG_CPU_800M=y
CONFIG_KERNEL_ADDR=0xc0000
CONFIG_FDT_ADDR=0x80100000
CONFIG_FDT_FLASH_ADDR=0xa0000
# CONFIG_RTS_NOR_BOOT is not set
CONFIG_RTS_NAND_BOOT=y
```

## chip/rts3917/sdk/rts39xx_sdk_v5.3/platform/board/rts3917/uboot_2020.04_3918n_nand_defconfig
```kconfig
CONFIG_BOARD_RTS3917=y
CONFIG_TARGET_ASIC=y
CONFIG_RTS3917_QFN88_DDR3_1GBIT=y
CONFIG_RTS3917_DDR_1866=y
CONFIG_DUAL_KERNEL_LOAD_CHECK=y
CONFIG_ENV_IN_FLASH=y
CONFIG_CPU_800M=y
CONFIG_KERNEL_ADDR=0x100000
CONFIG_KERNEL_SIZE=0x400000
CONFIG_FDT_ADDR=0x80100000
CONFIG_FDT_FLASH_ADDR=0x100000
CONFIG_FDT_B_FLASH_ADDR=0x140000
CONFIG_FDT_FLASH_SIZE=0x40000
# CONFIG_RTS_NOR_BOOT is not set
CONFIG_RTS_NAND_BOOT=y
```

## chip/rts3917/sdk/rts39xx_sdk_v5.3/platform/board/rts3917/uboot_2020.04_emulator_defconfig
```kconfig
CONFIG_BOARD_RTS3917=y
CONFIG_TARGET_EMULATOR=y
CONFIG_RTS3917_BGA325_DDR3_GENERAL=y
CONFIG_RTS3917_DDR_1866=y
CONFIG_ENV_IN_FLASH=y
CONFIG_KERNEL_ADDR=0xa0000
CONFIG_FDT_ADDR=0x80100000
```

## chip/rts3917/sdk/rts39xx_sdk_v5.3/platform/board/rts3917/uboot_2020.04_fpga_defconfig
```kconfig
CONFIG_BOARD_RTS3917=y
CONFIG_TARGET_FPGA=y
CONFIG_RTS3917_DDR_H5TQ2G=y
CONFIG_ENV_IN_FLASH=y
CONFIG_KERNEL_ADDR=0xa0000
CONFIG_FDT_ADDR=0x80100000
```

## chip/rts3917/sdk/rts39xx_sdk_v5.3/platform/board/rts3917/uboot_2023.01_3917n_defconfig
```kconfig
CONFIG_IPC_ARCH_PLATFORM="rts3917n"
CONFIG_SYS_MALLOC_LEN=0x2000000
CONFIG_TARGET_ASIC=y
CONFIG_RTS3917_QFN88_DDR2_512MBIT=y
CONFIG_RTS3917_DDR_1200=y
CONFIG_SELF_EXTRACTING=y
CONFIG_FIT=y
CONFIG_FIT_SIGNATURE=y
CONFIG_LEGACY_IMAGE_FORMAT=y
CONFIG_SPI_BOOT=y
# CONFIG_CMD_BDI is not set
# CONFIG_CMD_CONSOLE is not set
# CONFIG_CMD_IMI is not set
# CONFIG_CMD_XIMG is not set
# CONFIG_CMD_SAVEENV is not set
# CONFIG_CMD_CRC32 is not set
CONFIG_OF_CONTROL=y
# CONFIG_NET is not set
# CONFIG_I2C is not set
# CONFIG_INPUT is not set
CONFIG_MMC=y
# CONFIG_MMC_WRITE is not set
# CONFIG_POWER is not set
CONFIG_REGEX=y
# CONFIG_VPL_LZMA is not set
```

## chip/rts3917/sdk/rts39xx_sdk_v5.3/platform/board/rts3917/uboot_2023.01_3917n_emmc_defconfig
```kconfig
CONFIG_TARGET_ASIC=y
CONFIG_RTS3917_QFN88_DDR2_512MBIT=y
CONFIG_RTS3917_DDR_1200=y
# CONFIG_RTS_NOR_BOOT is not set
CONFIG_RTS_EMMC_BOOT=y
CONFIG_CMD_GPT=y
CONFIG_OF_CONTROL=y
```

## chip/rts3917/sdk/rts39xx_sdk_v5.3/platform/board/rts3917/uboot_2023.01_3917n_fastboot_defconfig
```kconfig
CONFIG_TARGET_ASIC=y
CONFIG_RTS3917_QFN88_DDR2_512MBIT=y
CONFIG_RTS3917_DDR_1200=y
CONFIG_OF_CONTROL=y
CONFIG_FAST_BOOT=y
```

## chip/rts3917/sdk/rts39xx_sdk_v5.3/platform/board/rts3917/uboot_2023.01_3917n_nand_defconfig
```kconfig
CONFIG_TARGET_ASIC=y
CONFIG_RTS3917_QFN88_DDR2_512MBIT=y
CONFIG_RTS3917_DDR_1200=y
CONFIG_DUAL_KERNEL_LOAD_CHECK=y
# CONFIG_RTS_NOR_BOOT is not set
CONFIG_RTS_NAND_BOOT=y
CONFIG_OF_CONTROL=y
```

## chip/rts3917/sdk/rts39xx_sdk_v5.3/platform/board/rts3917/uboot_2023.01_3918n_defconfig
```kconfig
CONFIG_TARGET_ASIC=y
CONFIG_RTS3917_QFN88_DDR3_1GBIT=y
CONFIG_RTS3917_DDR_1866=y
CONFIG_OF_CONTROL=y
```

## chip/rts3917/sdk/rts39xx_sdk_v5.3/platform/board/rts3917/uboot_2023.01_3918n_emmc_defconfig
```kconfig
CONFIG_TARGET_ASIC=y
CONFIG_RTS3917_QFN88_DDR3_1GBIT=y
CONFIG_RTS3917_DDR_1866=y
# CONFIG_RTS_NOR_BOOT is not set
CONFIG_RTS_EMMC_BOOT=y
CONFIG_CMD_GPT=y
CONFIG_OF_CONTROL=y
```

## chip/rts3917/sdk/rts39xx_sdk_v5.3/platform/board/rts3917/uboot_2023.01_3918n_nand_defconfig
```kconfig
CONFIG_TARGET_ASIC=y
CONFIG_RTS3917_QFN88_DDR3_1GBIT=y
CONFIG_RTS3917_DDR_1866=y
CONFIG_DUAL_KERNEL_LOAD_CHECK=y
# CONFIG_RTS_NOR_BOOT is not set
CONFIG_RTS_NAND_BOOT=y
CONFIG_OF_CONTROL=y
```

## chip/rts3917/sdk/rts39xx_sdk_v5.3/platform/configs/rts3917n_base_fastboot_defconfig
```kconfig
BR2_arm=y
BR2_cortex_a7=y
BR2_ARM_FPU_NEON_VFPV4=y
BR2_TOOLCHAIN_EXTERNAL=y
BR2_TOOLCHAIN_EXTERNAL_CUSTOM=y
BR2_TOOLCHAIN_EXTERNAL_PATH="$(TOPDIR)/../toolchain/asdk-12.4.1-a7-EL-6.6-u1.0-a32nh-linux-x86_64-250925"
BR2_TOOLCHAIN_EXTERNAL_CUSTOM_PREFIX="asdk-linux"
BR2_TOOLCHAIN_EXTERNAL_GCC_12=y
BR2_TOOLCHAIN_EXTERNAL_HEADERS_6_6=y
BR2_TOOLCHAIN_EXTERNAL_WCHAR=y
BR2_TOOLCHAIN_EXTERNAL_HAS_SSP=y
BR2_TOOLCHAIN_EXTERNAL_CXX=y
BR2_TOOLCHAIN_EXTERNAL_OPENMP=y
BR2_TOOLCHAIN_EXTRA_LIBS="libgomp.so* libssp.so* libthread_db*.so*"
BR2_TARGET_OPTIMIZATION="-fstrict-aliasing -fstrict-overflow -D_FORTIFY_SOURCE=2"
BR2_DL_DIR="$(TOPDIR)/../dl"
BR2_OPTIMIZE_S=y
BR2_PACKAGE_OVERRIDE_FILE="$(BR2_EXTERNAL)/local.mk"
BR2_GLOBAL_PATCH_DIR="$(BR2_EXTERNAL)/patches"
BR2_SSP_ALL=y
BR2_TARGET_GENERIC_HOSTNAME=""
BR2_TARGET_GENERIC_ISSUE=""
BR2_ROOTFS_MERGED_USR=y
BR2_SYSTEM_ENABLE_NLS=y
BR2_ROOTFS_OVERLAY="$(BR2_EXTERNAL)/board/rts3917/rootfs_overlay_fastboot"
BR2_ROOTFS_POST_BUILD_SCRIPT="$(BR2_EXTERNAL)/board/rts3917/post_build.sh"
BR2_ROOTFS_POST_IMAGE_SCRIPT="$(BR2_EXTERNAL)/board/rts3917/post_image.sh"
BR2_LINUX_KERNEL_CUSTOM_VERSION=y
BR2_LINUX_KERNEL_CUSTOM_VERSION_VALUE="6.6"
BR2_LINUX_KERNEL_USE_CUSTOM_CONFIG=y
BR2_LINUX_KERNEL_CUSTOM_CONFIG_FILE="$(BR2_EXTERNAL)/board/rts3917/linux_$(BR2_LINUX_KERNEL_CUSTOM_VERSION_VALUE)_fastboot_defconfig"
BR2_LINUX_KERNEL_APPENDED_UIMAGE=y
BR2_LINUX_KERNEL_LZO=y
BR2_LINUX_KERNEL_UIMAGE_LOADADDR="0x81000000"
BR2_LINUX_KERNEL_INTREE_DTS_NAME="realtek/rts3917n_evb"
BR2_PACKAGE_BUSYBOX_CONFIG="$(BR2_EXTERNAL)/board/rts3917/busybox_fastboot.config"
BR2_PACKAGE_ALSA_LIB_PCM_PLUGINS=""
BR2_PACKAGE_ALSA_LIB_CTL_PLUGINS=""
# BR2_PACKAGE_ALSA_LIB_ALOAD is not set
# BR2_PACKAGE_ALSA_LIB_RAWMIDI is not set
# BR2_PACKAGE_ALSA_LIB_HWDEP is not set
# BR2_PACKAGE_ALSA_LIB_SEQ is not set
# BR2_PACKAGE_ALSA_LIB_UCM is not set
# BR2_PACKAGE_ALSA_LIB_ALISP is not set
# BR2_PACKAGE_ALSA_LIB_OLD_SYMBOLS is not set
BR2_PACKAGE_ZLIB=y
BR2_PACKAGE_FREETYPE=y
# BR2_PACKAGE_IFUPDOWN_SCRIPTS is not set
BR2_PACKAGE_IPTABLES=y
# BR2_PACKAGE_URANDOM_SCRIPTS is not set
BR2_TARGET_ROOTFS_SQUASHFS=y
BR2_TARGET_ROOTFS_SQUASHFS4_LZO=y
# BR2_TARGET_ROOTFS_TAR is not set
BR2_TARGET_UBOOT=y
BR2_TARGET_UBOOT_BUILD_SYSTEM_KCONFIG=y
BR2_TARGET_UBOOT_CUSTOM_VERSION=y
BR2_TARGET_UBOOT_CUSTOM_VERSION_VALUE="2023.01"
BR2_TARGET_UBOOT_USE_CUSTOM_CONFIG=y
BR2_TARGET_UBOOT_CUSTOM_CONFIG_FILE="$(BR2_EXTERNAL)/board/rts3917/uboot_$(BR2_TARGET_UBOOT_CUSTOM_VERSION_VALUE)_3917n_fastboot_defconfig"
BR2_TARGET_UBOOT_CUSTOM_MAKEOPTS="EXT_DTB=u-boot.dtb"
BR2_PACKAGE_HOST_MTD=y
BR2_PACKAGE_CMOS_SENSOR_LIST="sc2310_mipi,sc3235,sc401ai,sc4238_mipi,sc5335p,sc8238_15fps,imx307,jxf22,sc3338_mipi,fixp,default"
BR2_PACKAGE_RTSTREAM_MJPEG=y
# BR2_PACKAGE_LIBRTSCRYPT is not set
BR2_PACKAGE_LIBFSMGR=y
# BR2_PACKAGE_IPCAM_TOTAL_SOLUTION is not set
BR2_PACKAGE_GAIA_FAST=y
# BR2_PACKAGE_WEBPAGES is not set
BR2_PACKAGE_HOST_PYTHON3_PYDEVICETREE=y
```
